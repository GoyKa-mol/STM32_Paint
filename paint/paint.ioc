# file: paint.ioc
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ADC1.Channel-0\#ChannelRegularConversion=ADC_CHANNEL_0
ADC1.NbrOfConversionFlag=1
ADC1.Rank-0\#ChannelRegularConversion=1
ADC1.SamplingTime-0\#ChannelRegularConversion=ADC_SAMPLETIME_3CYCLES
ADC1.master=1
ADC3.Channel-0\#ChannelRegularConversion=ADC_CHANNEL_6
ADC3.Channel-IN4=ADC_CHANNEL_4
ADC3.Channel-IN5=ADC_CHANNEL_5
FREERTOS.INCLUDE_vTaskDelayUntil=1
FREERTOS.Mutexes01=myMutexLCD,Dynamic,NULL
FREERTOS.Tasks01=defaultTask,-3,128,StartDefaultTask,Default,NULL,Dynamic,NULL,NULL;Mode,1,4096,StartMode,Default,NULL,Dynamic,NULL,NULL;Peindre,-2,1024,StartPeindre,Default,NULL,Dynamic,NULL,NULL;TaskEtat,2,1024,StartTaskEtat,Default,NULL,Dynamic,NULL,NULL
FREERTOS.configCHECK_FOR_STACK_OVERFLOW=2
FREERTOS.configTOTAL_HEAP_SIZE=32768
FREERTOS.configUSE_APPLICATION_TASK_TAG=1
FREERTOS.configUSE_COUNTING_SEMAPHORES=1
FREERTOS.configUSE_IDLE_HOOK=1
FREERTOS.configUSE_MALLOC_FAILED_HOOK=1
FREERTOS.configUSE_RECURSIVE_MUTEXES=1
I2C1.Timing=0x00C0EAFF
I2C3.Timing=0x00C0EAFF
LTDC.ActiveH=272
LTDC.ActiveW=480
LTDC.Alpha_L0=255
LTDC.BlendingFactor1_L0=LTDC_BLENDING_FACTOR1_PAxCA
LTDC.BlendingFactor2_L0=LTDC_BLENDING_FACTOR2_PAxCA
LTDC.FBStartAdress_L0=0xC0000000
LTDC.HBP=13
LTDC.HFP=32
LTDC.HSync=41
LTDC.ImageHeight_L0=272
LTDC.ImageWidth_L0=480
LTDC.Layers=0
LTDC.PixelFormat_L0=LTDC_PIXEL_FORMAT_RGB565
LTDC.VSync=10
LTDC.WindowX1_L0=480
LTDC.WindowY1_L0=272
Mcu.Family=STM32F7
Mcu.Name=STM32F746NGHx
Mcu.Package=TFBGA216
NVIC.EXTI15_10_IRQn=true\:5\:0\:false\:false\:true\:true\:true\:true
NVIC.EXTI9_5_IRQn=true\:5\:0\:false\:false\:true\:true\:true\:true
NVIC.LTDC_IRQn=true\:5\:0\:false\:false\:true\:true\:true\:true
NVIC.PriorityGroup=NVIC_PRIORITYGROUP_4
NVIC.TIM6_DAC_IRQn=true\:0\:0\:false\:false\:true\:false\:false\:true
NVIC.TimeBase=TIM6_DAC_IRQn
NVIC.TimeBaseIP=TIM6
NVIC.USART1_IRQn=true\:5\:0\:false\:false\:true\:true\:true\:true
PA0/WKUP.Signal=ADCx_IN0
PA13.GPIO_Label=SWDIO
PA13.Mode=Serial_Wire
PA13.Signal=SYS_JTMS-SWDIO
PA14.GPIO_Label=SWCLK
PA14.Mode=Serial_Wire
PA14.Signal=SYS_JTCK-SWCLK
PA15.GPIO_Label=BP2
PA15.Signal=GPXTI15
PA3.GPIO_Label=ULPI_D0 [USB3320C-EZK_D0]
PA3.Mode=Host_HS
PA3.Signal=USB_OTG_HS_ULPI_D0
PA4.Signal=COMP_DAC1_group
PA5.GPIO_Label=ULPI_CLK [USB3320C-EZK_CLKOUT]
PA5.Mode=Host_HS
PA5.Signal=USB_OTG_HS_ULPI_CK
PA8.GPIO_Label=BP1
PA8.Signal=GPXTI8
PA9.GPIO_Label=VCP_TX [STM32F103CBT6_PA3]
PA9.GPIO_Mode=GPIO_MODE_AF_PP
PA9.GPIO_PuPd=GPIO_NOPULL
PA9.GPIO_Speed=GPIO_SPEED_FREQ_LOW
PA9.Mode=Asynchronous
PA9.Signal=USART1_TX
PB0.GPIO_Label=ULPI_D1 [USB3320C-EZK_D1]
PB0.Mode=Host_HS
PB0.Signal=USB_OTG_HS_ULPI_D1
PB1.GPIO_Label=ULPI_D2 [USB3320C-EZK_D2]
PB1.Mode=Host_HS
PB1.Signal=USB_OTG_HS_ULPI_D2
PB11.GPIO_Label=ULPI_D4 [USB3320C-EZK_D4]
PB11.Mode=Host_HS
PB11.Signal=USB_OTG_HS_ULPI_D4
PB12.GPIO_Label=ULPI_D5 [USB3320C-EZK_D5]
PB12.Mode=Host_HS
PB12.Signal=USB_OTG_HS_ULPI_D5
PB13.GPIO_Label=ULPI_D6 [USB3320C-EZK_D6]
PB13.Mode=Host_HS
PB13.Signal=USB_OTG_HS_ULPI_D6
PB14.Mode=Full_Duplex_Master
PB14.Signal=SPI2_MISO
PB15.Mode=Full_Duplex_Master
PB15.Signal=SPI2_MOSI
PB4.Signal=S_TIM3_CH1
PB5.GPIO_Label=ULPI_D7 [USB3320C-EZK_D7]
PB5.Mode=Host_HS
PB5.Signal=USB_OTG_HS_ULPI_D7
PB7.GPIO_Label=VCP_RX [STM32F103CBT6_PA2]
PB7.GPIO_Mode=GPIO_MODE_AF_PP
PB7.GPIO_PuPd=GPIO_NOPULL
PB7.GPIO_Speed=GPIO_SPEED_FREQ_LOW
PB7.Mode=Asynchronous
PB7.Signal=USART1_RX
PB8.GPIO_Label=ARDUINO SCL/D15
PB8.GPIO_Mode=GPIO_MODE_AF_OD
PB8.GPIO_PuPd=GPIO_NOPULL
PB8.GPIO_Speed=GPIO_SPEED_FREQ_LOW
PB8.Mode=I2C
PB8.Signal=I2C1_SCL
PB9.GPIO_Label=ARDUINO SDA/D14
PB9.GPIO_Mode=GPIO_MODE_AF_OD
PB9.GPIO_PuPd=GPIO_NOPULL
PB9.GPIO_Speed=GPIO_SPEED_FREQ_LOW
PB9.Mode=I2C
PB9.Signal=I2C1_SDA
PC0.GPIO_Label=ULPI_STP [USB3320C-EZK_STP]
PC0.Mode=Host_HS
PC0.Signal=USB_OTG_HS_ULPI_STP
PC13.GPIO_Label=uSD_Detect
PC13.Signal=GPIO_Input
PC14/OSC32_IN.GPIO_Label=RCC_OSC32_IN
PC14/OSC32_IN.Mode=LSE-External-Oscillator
PC14/OSC32_IN.Signal=RCC_OSC32_IN
PC15/OSC32_OUT.GPIO_Label=RCC_OSC32_OUT
PC15/OSC32_OUT.Mode=LSE-External-Oscillator
PC15/OSC32_OUT.Signal=RCC_OSC32_OUT
PC2.GPIO_Label=ULPI_DIR [USB3320C-EZK_DIR]
PC2.Mode=Host_HS
PC2.Signal=USB_OTG_HS_ULPI_DIR
PC3.Mode=SdramChipSelect1_1
PC3.Signal=FMC_SDCKE0
PC6.Mode=Asynchronous
PC6.Signal=USART6_TX
PC7.Mode=Asynchronous
PC7.Signal=USART6_RX
PD0.Signal=FMC_D2_DA2
PD1.Signal=FMC_D3_DA3
PD10.Signal=FMC_D15_DA15
PD14.Signal=FMC_D0_DA0
PD15.Signal=FMC_D1_DA1
PD3.GPIO_Label=LED16
PD3.Signal=GPIO_Output
PD4.GPIO_Label=OTG_FS_OverCurrent [STMPS2141STR_Fault]
PD4.Signal=GPIO_Input
PD5.GPIO_Label=OTG_FS_PowerSwitchOn [STMPS2141STR_EN]
PD5.PinState=GPIO_PIN_SET
PD5.Signal=GPIO_Output
PD6.GPIO_Label=Audio_INT
PD6.GPIO_ModeDefaultEXTI=GPIO_MODE_EVT_RISING
PD6.Signal=GPXTI6
PD8.Signal=FMC_D13_DA13
PD9.Signal=FMC_D14_DA14
PE0.Signal=FMC_NBL0
PE1.Signal=FMC_NBL1
PE10.Signal=FMC_D7_DA7
PE11.Signal=FMC_D8_DA8
PE12.Signal=FMC_D9_DA9
PE13.Signal=FMC_D10_DA10
PE14.Signal=FMC_D11_DA11
PE15.Signal=FMC_D12_DA12
PE3.Signal=GPIO_Input
PE4.GPIO_Label=LCD_B0 [RK043FN48H-CT672B_B0]
PE4.Mode=RGB888
PE4.Signal=LTDC_B0
PE5.GPIO_Label=LED14
PE5.Signal=GPIO_Output
PE6.GPIO_Label=LED15
PE6.Signal=GPIO_Output
PE7.Signal=FMC_D4_DA4
PE8.Signal=FMC_D5_DA5
PE9.Signal=FMC_D6_DA6
PF0.Signal=FMC_A0
PF1.Signal=FMC_A1
PF10.Mode=IN8
PF10.Signal=ADC3_IN8
PF11.Signal=FMC_SDNRAS
PF12.Signal=FMC_A6
PF13.Signal=FMC_A7
PF14.Signal=FMC_A8
PF15.Signal=FMC_A9
PF2.Signal=FMC_A2
PF3.Signal=FMC_A3
PF4.Signal=FMC_A4
PF5.Signal=FMC_A5
PF6.Mode=Asynchronous
PF6.Signal=UART7_RX
PF7.Mode=Asynchronous
PF7.Signal=UART7_TX
PF8.Mode=IN6
PF8.Signal=ADC3_IN6
PF9.Mode=IN7
PF9.Signal=ADC3_IN7
PG0.Signal=FMC_A10
PG1.Signal=FMC_A11
PG12.GPIO_Label=LCD_B4 [RK043FN48H-CT672B_B4]
PG12.Mode=RGB888
PG12.Signal=LTDC_B4
PG15.Signal=FMC_SDNCAS
PG2.GPIO_Label=RMII_RXER
PG2.Signal=GPIO_Input
PG3.GPIO_Label=EXT_RST
PG3.Signal=GPIO_Output
PG4.Signal=FMC_A14_BA0
PG5.Signal=FMC_A15_BA1
PG7.GPIO_Label=BP_joystick
PG7.Signal=GPXTI7
PG8.Signal=FMC_SDCLK
PH0/OSC_IN.GPIO_Label=OSC_25M [NZ2520SB-25.00M_OUT]
PH0/OSC_IN.Mode=HSE-External-Oscillator
PH0/OSC_IN.Signal=RCC_OSC_IN
PH1/OSC_OUT.Mode=HSE-External-Oscillator
PH1/OSC_OUT.Signal=RCC_OSC_OUT
PH10.GPIO_Label=LED18
PH10.Signal=GPIO_Output
PH11.GPIO_Label=LED12
PH11.Signal=GPIO_Output
PH12.GPIO_Label=LED17
PH12.Signal=GPIO_Output
PH14.GPIO_Label=LED13
PH14.Signal=GPIO_Output
PH15.GPIO_Label=TP3
PH15.Signal=GPIO_Input
PH2.GPIO_Label=NC2
PH2.Signal=GPIO_Input
PH3.Mode=SdramChipSelect1_1
PH3.Signal=FMC_SDNE0
PH4.GPIO_Label=ULPI_NXT [USB3320C-EZK_NXT]
PH4.Mode=Host_HS
PH4.Signal=USB_OTG_HS_ULPI_NXT
PH5.Signal=FMC_SDNWE
PH6.GPIO_Label=LED2
PH6.Signal=GPIO_Output
PH7.GPIO_Label=LCD_SCL [RK043FN48H-CT672B_SCL]
PH7.Mode=I2C
PH7.Signal=I2C3_SCL
PH8.GPIO_Label=LCD_SDA [RK043FN48H-CT672B_SDA]
PH8.Mode=I2C
PH8.Signal=I2C3_SDA
PH9.GPIO_Label=LED11
PH9.Signal=GPIO_Output
PI0.Mode=NSS_Signal_Hard_Output
PI0.Signal=SPI2_NSS
PI1.GPIO_Label=ARDUINO SCK/D13
PI1.GPIO_Mode=GPIO_MODE_AF_PP
PI1.GPIO_PuPd=GPIO_NOPULL
PI1.GPIO_Speed=GPIO_SPEED_FREQ_LOW
PI1.Mode=Full_Duplex_Master
PI1.Signal=SPI2_SCK
PI10.GPIO_Label=LCD_HSYNC [RK043FN48H-CT672B_HSYNC]
PI10.Mode=RGB888
PI10.Signal=LTDC_HSYNC
PI12.GPIO_Label=LCD_DISP [RK043FN48H-CT672B_DISP] 
PI12.PinState=GPIO_PIN_SET
PI12.Signal=GPIO_Output
PI13.GPIO_Label=LCD_INT
PI13.GPIO_ModeDefaultEXTI=GPIO_MODE_EVT_RISING
PI13.Signal=GPXTI13
PI14.GPIO_Label=LCD_CLK [RK043FN48H-CT672B_CLK]
PI14.Mode=RGB888
PI14.Signal=LTDC_CLK
PI15.GPIO_Label=LCD_R0 [RK043FN48H-CT672B_R0]
PI15.Mode=RGB888
PI15.Signal=LTDC_R0
PI2.Signal=S_TIM8_CH4
PI3.GPIO_Label=LED3
PI3.Signal=GPIO_Output
PI8.GPIO_Label=NC1 [TP2]
PI8.Mode=Timestamp enabled - Input Enabled to TS
PI8.Signal=RTC_TS
PI9.GPIO_Label=LCD_VSYNC [RK043FN48H-CT672B_VSYNC]
PI9.Mode=RGB888
PI9.Signal=LTDC_VSYNC
PJ0.GPIO_Label=LCD_R1 [RK043FN48H-CT672B_R1]
PJ0.Mode=RGB888
PJ0.Signal=LTDC_R1
PJ1.GPIO_Label=LCD_R2 [RK043FN48H-CT672B_R2]
PJ1.Mode=RGB888
PJ1.Signal=LTDC_R2
PJ10.GPIO_Label=LCD_G3 [RK043FN48H-CT672B_G3]
PJ10.Mode=RGB888
PJ10.Signal=LTDC_G3
PJ11.GPIO_Label=LCD_G4 [RK043FN48H-CT672B_G4]
PJ11.Mode=RGB888
PJ11.Signal=LTDC_G4
PJ12.GPIO_Label=OTG_FS_VBUS
PJ12.Signal=GPIO_Input
PJ13.GPIO_Label=LCD_B1 [RK043FN48H-CT672B_B1]
PJ13.Mode=RGB888
PJ13.Signal=LTDC_B1
PJ14.GPIO_Label=LCD_B2 [RK043FN48H-CT672B_B2]
PJ14.Mode=RGB888
PJ14.Signal=LTDC_B2
PJ15.GPIO_Label=LCD_B3 [RK043FN48H-CT672B_B3]
PJ15.Mode=RGB888
PJ15.Signal=LTDC_B3
PJ2.GPIO_Label=LCD_R3 [RK043FN48H-CT672B_R3]
PJ2.Mode=RGB888
PJ2.Signal=LTDC_R3
PJ3.GPIO_Label=LCD_R4 [RK043FN48H-CT672B_R4]
PJ3.Mode=RGB888
PJ3.Signal=LTDC_R4
PJ4.GPIO_Label=LCD_R5 [RK043FN48H-CT672B_R5]
PJ4.Mode=RGB888
PJ4.Signal=LTDC_R5
PJ5.GPIO_Label=LCD_R6 [RK043FN48H-CT672B_R6]
PJ5.Mode=RGB888
PJ5.Signal=LTDC_R6
PJ6.GPIO_Label=LCD_R7 [RK043FN48H-CT672B_R7]
PJ6.Mode=RGB888
PJ6.Signal=LTDC_R7
PJ7.GPIO_Label=LCD_G0 [RK043FN48H-CT672B_G0]
PJ7.Mode=RGB888
PJ7.Signal=LTDC_G0
PJ8.GPIO_Label=LCD_G1 [RK043FN48H-CT672B_G1]
PJ8.Mode=RGB888
PJ8.Signal=LTDC_G1
PJ9.GPIO_Label=LCD_G2 [RK043FN48H-CT672B_G2]
PJ9.Mode=RGB888
PJ9.Signal=LTDC_G2
PK0.GPIO_Label=LCD_G5 [RK043FN48H-CT672B_G5]
PK0.Mode=RGB888
PK0.Signal=LTDC_G5
PK1.GPIO_Label=LCD_G6 [RK043FN48H-CT672B_G6]
PK1.Mode=RGB888
PK1.Signal=LTDC_G6
PK2.GPIO_Label=LCD_G7 [RK043FN48H-CT672B_G7]
PK2.Mode=RGB888
PK2.Signal=LTDC_G7
PK3.GPIO_Label=LCD_BL_CTRL [STLD40DPUR_EN]
PK3.GPIO_Speed=GPIO_SPEED_FREQ_LOW
PK3.PinState=GPIO_PIN_SET
PK3.Signal=GPIO_Output
PK4.GPIO_Label=LCD_B5 [RK043FN48H-CT672B_B5]
PK4.Mode=RGB888
PK4.Signal=LTDC_B5
PK5.GPIO_Label=LCD_B6 [RK043FN48H-CT672B_B6]
PK5.Mode=RGB888
PK5.Signal=LTDC_B6
PK6.GPIO_Label=LCD_B7 [RK043FN48H-CT672B_B7]
PK6.Mode=RGB888
PK6.Signal=LTDC_B7
PK7.GPIO_Label=LCD_DE [RK043FN48H-CT672B_DE]
PK7.Mode=RGB888
PK7.Signal=LTDC_DE
ProjectManager.HeapSize=0x200
ProjectManager.StackSize=0x400
ProjectManager.TargetToolchain=STM32CubeIDE
RCC.AHBFreq_Value=200000000
RCC.APB1CLKDivider=RCC_HCLK_DIV4
RCC.APB1Freq_Value=50000000
RCC.APB1TimFreq_Value=100000000
RCC.APB2CLKDivider=RCC_HCLK_DIV2
RCC.APB2Freq_Value=100000000
RCC.APB2TimFreq_Value=200000000
RCC.CortexFreq_Value=200000000
RCC.HCLKFreq_Value=200000000
RCC.HSE_VALUE=25000000
RCC.HSI_VALUE=16000000
RCC.PLL48CLockSelection=RCC_CLK48SOURCE_PLLSAIP
RCC.PLLI2SN=100
RCC.PLLM=25
RCC.PLLN=400
RCC.PLLQ=9
RCC.PLLSAIN=384
RCC.PLLSAIP=RCC_PLLSAIP_DIV8
RCC.PLLSAIR=5
RCC.PLLSAIRDiv=RCC_PLLSAIDIVR_8
RCC.PLLSourceVirtual=RCC_PLLSOURCE_HSE
RCC.SDMMCClockSelection=RCC_SDMMC1CLKSOURCE_CLK48
RCC.SYSCLKFreq_VALUE=200000000
RCC.SYSCLKSource=RCC_SYSCLKSOURCE_PLLCLK
RCC.USBFreq_Value=48000000
RCC.VCOOutputFreq_Value=400000000
RTC.Alarm-Alarm\ A=RTC_ALARM_A
RTC.Alarm_B-Alarm\ B=RTC_ALARM_B
SH.ADCx_IN0.0=ADC1_IN0,IN0
SH.COMP_DAC1_group.0=DAC_OUT1,DAC_OUT1
SH.FMC_A0.0=FMC_A0,12b-sda1
SH.FMC_A1.0=FMC_A1,12b-sda1
SH.FMC_A10.0=FMC_A10,12b-sda1
SH.FMC_A11.0=FMC_A11,12b-sda1
SH.FMC_A14_BA0.0=FMC_BA0,FourSdramBanks1
SH.FMC_A15_BA1.0=FMC_BA1,FourSdramBanks1
SH.FMC_A2.0=FMC_A2,12b-sda1
SH.FMC_A3.0=FMC_A3,12b-sda1
SH.FMC_A4.0=FMC_A4,12b-sda1
SH.FMC_A5.0=FMC_A5,12b-sda1
SH.FMC_A6.0=FMC_A6,12b-sda1
SH.FMC_A7.0=FMC_A7,12b-sda1
SH.FMC_A8.0=FMC_A8,12b-sda1
SH.FMC_A9.0=FMC_A9,12b-sda1
SH.FMC_D0_DA0.0=FMC_D0,sd-16b-d1
SH.FMC_D10_DA10.0=FMC_D10,sd-16b-d1
SH.FMC_D11_DA11.0=FMC_D11,sd-16b-d1
SH.FMC_D12_DA12.0=FMC_D12,sd-16b-d1
SH.FMC_D13_DA13.0=FMC_D13,sd-16b-d1
SH.FMC_D14_DA14.0=FMC_D14,sd-16b-d1
SH.FMC_D15_DA15.0=FMC_D15,sd-16b-d1
SH.FMC_D1_DA1.0=FMC_D1,sd-16b-d1
SH.FMC_D2_DA2.0=FMC_D2,sd-16b-d1
SH.FMC_D3_DA3.0=FMC_D3,sd-16b-d1
SH.FMC_D4_DA4.0=FMC_D4,sd-16b-d1
SH.FMC_D5_DA5.0=FMC_D5,sd-16b-d1
SH.FMC_D6_DA6.0=FMC_D6,sd-16b-d1
SH.FMC_D7_DA7.0=FMC_D7,sd-16b-d1
SH.FMC_D8_DA8.0=FMC_D8,sd-16b-d1
SH.FMC_D9_DA9.0=FMC_D9,sd-16b-d1
SH.FMC_NBL0.0=FMC_NBL0,Sd2ByteEnable1
SH.FMC_NBL1.0=FMC_NBL1,Sd2ByteEnable1
SH.FMC_SDCLK.0=FMC_SDCLK,12b-sda1
SH.FMC_SDNCAS.0=FMC_SDNCAS,12b-sda1
SH.FMC_SDNRAS.0=FMC_SDNRAS,12b-sda1
SH.FMC_SDNWE.0=FMC_SDNWE,12b-sda1
SH.S_TIM3_CH1.0=TIM3_CH1,PWM Generation1 CH1
SH.S_TIM8_CH4.0=TIM8_CH4,PWM Generation4 CH4
SPI2.CalculateBaudRate=25.0 MBits/s
SPI2.Direction=SPI_DIRECTION_2LINES
SPI2.Mode=SPI_MODE_MASTER
SPI2.VirtualNSS=VM_NSSHARD
SPI2.VirtualType=VM_MASTER
TIM3.Channel-PWM\ Generation1\ CH1=TIM_CHANNEL_1
TIM8.Channel-PWM\ Generation4\ CH4=TIM_CHANNEL_4
USART1.VirtualMode-Asynchronous=VM_ASYNC
USART6.VirtualMode-Asynchronous=VM_ASYNC
VP_DMA2D_VS_DMA2D.Mode=DMA2D_Activate
VP_FREERTOS_VS_CMSIS_V1.Mode=CMSIS_V1
VP_RTC_VS_RTC_Activate.Mode=RTC_Enabled
VP_RTC_VS_RTC_Alarm_A_Intern.Mode=Alarm A
VP_RTC_VS_RTC_Alarm_B_Intern.Mode=Alarm B
VP_RTC_VS_RTC_Calendar.Mode=RTC_Calendar
VP_SYS_VS_tim6.Mode=TIM6
VP_TIM1_VS_ClockSourceINT.Mode=Internal
VP_TIM2_VS_ClockSourceINT.Mode=Internal
VP_TIM3_VS_ClockSourceINT.Mode=Internal
VP_TIM3_VS_ClockSourceITR.Mode=TriggerSource_ITR0
VP_TIM5_VS_ClockSourceINT.Mode=Internal
VP_TIM8_VS_ClockSourceINT.Mode=Internal
board=STM32F746G-DISCO

// file: Core/Src/main.c
/* USER CODE BEGIN Header */
/**
  ******************************************************************************
  * @file           : main.c
  * @brief          : Main program body
  ******************************************************************************
  * @attention
  *
  * <h2><center>&copy; Copyright (c) 2021 STMicroelectronics.
  * All rights reserved.</center></h2>
  *
  * This software component is licensed by ST under Ultimate Liberty license
  * SLA0044, the "License"; You may not use this file except in compliance with
  * the License. You may obtain a copy of the License at:
  *                             www.st.com/SLA0044
  *
  ******************************************************************************
  */
/* USER CODE END Header */
#include "main.h"
#include "cmsis_os.h"

/* USER CODE BEGIN Includes */
#include "stm32746g_discovery_lcd.h"
#include "stm32746g_discovery_ts.h"
#include "stdio.h"
#include "math.h"
#include "bitmap.h"
/* USER CODE END Includes */

ADC_HandleTypeDef hadc1;
ADC_HandleTypeDef hadc3;

DAC_HandleTypeDef hdac;

DMA2D_HandleTypeDef hdma2d;

I2C_HandleTypeDef hi2c1;
I2C_HandleTypeDef hi2c3;

LTDC_HandleTypeDef hltdc;

RTC_HandleTypeDef hrtc;

SPI_HandleTypeDef hspi2;

TIM_HandleTypeDef htim1;
TIM_HandleTypeDef htim2;
TIM_HandleTypeDef htim3;
TIM_HandleTypeDef htim5;
TIM_HandleTypeDef htim8;

UART_HandleTypeDef huart7;
UART_HandleTypeDef huart1;
UART_HandleTypeDef huart6;

SDRAM_HandleTypeDef hsdram1;

osThreadId defaultTaskHandle;
osThreadId ModeHandle;
osThreadId PeindreHandle;
osThreadId TaskEtatHandle;
osMutexId myMutexLCDHandle;

void SystemClock_Config(void);
static void MX_GPIO_Init(void);
static void MX_ADC3_Init(void);
static void MX_I2C1_Init(void);
static void MX_I2C3_Init(void);
static void MX_LTDC_Init(void);
static void MX_RTC_Init(void);
static void MX_SPI2_Init(void);
static void MX_TIM1_Init(void);
static void MX_TIM2_Init(void);
static void MX_TIM3_Init(void);
static void MX_TIM5_Init(void);
static void MX_TIM8_Init(void);
static void MX_USART1_UART_Init(void);
static void MX_USART6_UART_Init(void);
static void MX_ADC1_Init(void);
static void MX_DAC_Init(void);
static void MX_UART7_Init(void);
static void MX_FMC_Init(void);
static void MX_DMA2D_Init(void);
void StartDefaultTask(void const * argument);
void StartMode(void const * argument);
void StartPeindre(void const * argument);
void StartTaskEtat(void const * argument);

/* USER CODE BEGIN 0 */
#define Radius 15
void HAL_UART_RxCpltCallback(UART_HandleTypeDef *huart);
#define taille_menu 50 // largeur à droite du menu, doit être pair
#define etat_max 6 // nombre d'état possible (état 0 exclu)
#define max_brush 2
#define haut_menu 32 //hauteur de perception des toucher tactile pour le menu du bas
char radius = 10;
char brush = 1;
char layer = 0;
uint32_t couleur;
/*
 etat :
 	 '0' : rien
 	 '1' : menu
 	 '2' : calque
 	 '3' : brush
 	 '4' : alpha
 	 '5' : couleur
 	 '6' : taille
*/
char etat = 1; // On commence à l'état du menu
char etat_int = 2; //état intermédiaire (sur lequel le curseur est)
void HAL_UART_RxCpltCallback(UART_HandleTypeDef *huart);
void HAL_GPIO_EXTI_Callback(uint16_t GPIO_Pin);
char TestConditionBord(uint16_t x,uint16_t y,uint16_t radius);
void LCD_PAINTBRUSH(uint16_t x, uint16_t y,uint16_t rad);
void LCD_PAINTBRUSH_SAMPLE(uint16_t x, uint16_t y,uint16_t rad);
void AfficheTonalite();
uint32_t FindCouleur(float ton, float sat, float lum);
void AfficheLuminosite(float ton, float sat);
void AfficheSaturation(float ton, float lum);
float FindSaturation(uint16_t pos);
float FindTonalite(uint16_t pos);
float FindLuminosite(uint16_t pos);
float modulo(float val, char mod);
float absolu(float val);
uint8_t rxbuffer[10]; //var globale
/* USER CODE END 0 */

int main(void)
{
  /* USER CODE BEGIN 1 */
	char text[50]={};
	static TS_StateTypeDef  TS_State;
	uint32_t potl,potr,joystick_h, joystick_v;
	ADC_ChannelConfTypeDef sConfig = {0};
	sConfig.Rank = ADC_REGULAR_RANK_1;
	sConfig.SamplingTime = ADC_SAMPLETIME_3CYCLES;
  /* USER CODE END 1 */

  /* MCU Configuration--------------------------------------------------------*/

  /* Reset of all peripherals, Initializes the Flash interface and the Systick. */
  HAL_Init();

  /* Configure the system clock */
  SystemClock_Config();

  /* Initialize all configured peripherals */
  MX_GPIO_Init();
  MX_ADC3_Init();
  MX_I2C1_Init();
  MX_I2C3_Init();
  MX_LTDC_Init();
  MX_RTC_Init();
  MX_SPI2_Init();
  MX_TIM1_Init();
  MX_TIM2_Init();
  MX_TIM3_Init();
  MX_TIM5_Init();
  MX_TIM8_Init();
  MX_USART1_UART_Init();
  MX_USART6_UART_Init();
  MX_ADC1_Init();
  MX_DAC_Init();
  MX_UART7_Init();
  MX_FMC_Init();
  MX_DMA2D_Init();
  /* USER CODE BEGIN 2 */
  BSP_LCD_Init();
  BSP_LCD_LayerDefaultInit(0, LCD_FB_START_ADDRESS);
  BSP_LCD_LayerDefaultInit(1, LCD_FB_START_ADDRESS+ BSP_LCD_GetXSize()*BSP_LCD_GetYSize()*4);
  BSP_LCD_DisplayOn();
  BSP_LCD_SetFont(&Font12);
  BSP_LCD_SetBackColor(LCD_COLOR_WHITE);
  BSP_LCD_SelectLayer(1);
  BSP_LCD_Clear(LCD_COLOR_TRANSPARENT);
  BSP_LCD_SetTextColor(LCD_COLOR_BLACK);
  BSP_LCD_FillRect(0, 245, 480, 5);
  BSP_LCD_FillRect(480-5-taille_menu, 0, 5, 245);
  BSP_LCD_SelectLayer(0);
  BSP_LCD_Clear(LCD_COLOR_WHITE);
  BSP_LCD_SetTextColor(LCD_COLOR_RED);

  BSP_TS_Init(BSP_LCD_GetXSize(), BSP_LCD_GetYSize());
  /* USER CODE END 2 */

  /* Create the mutex(es) */
  /* definition and creation of myMutexLCD */
  osMutexDef(myMutexLCD);
  myMutexLCDHandle = osMutexCreate(osMutex(myMutexLCD));

  /* Create the thread(s) */
  /* definition and creation of defaultTask */
  osThreadDef(defaultTask, StartDefaultTask, osPriorityIdle, 0, 128);
  defaultTaskHandle = osThreadCreate(osThread(defaultTask), NULL);

  /* definition and creation of Mode */
  osThreadDef(Mode, StartMode, osPriorityAboveNormal, 0, 4096);
  ModeHandle = osThreadCreate(osThread(Mode), NULL);

  /* definition and creation of Peindre */
  osThreadDef(Peindre, StartPeindre, osPriorityLow, 0, 1024);
  PeindreHandle = osThreadCreate(osThread(Peindre), NULL);

  /* definition and creation of TaskEtat */
  osThreadDef(TaskEtat, StartTaskEtat, osPriorityHigh, 0, 1024);
  TaskEtatHandle = osThreadCreate(osThread(TaskEtat), NULL);

  /* Start scheduler */
  osKernelStart();

  /* We should never get here as control is now taken by the scheduler */
  /* Infinite loop */
  /* USER CODE BEGIN WHILE */
  while (1)
  {
	  HAL_GPIO_WritePin(LED13_GPIO_Port,LED13_Pin,HAL_GPIO_ReadPin(BP1_GPIO_Port,BP1_Pin));
	  HAL_GPIO_WritePin(LED14_GPIO_Port,LED14_Pin,HAL_GPIO_ReadPin(BP2_GPIO_Port,BP2_Pin));
	  sprintf(text,"BP1 : %d",HAL_GPIO_ReadPin(BP1_GPIO_Port,BP1_Pin));
	  BSP_LCD_DisplayStringAtLine(5,(uint8_t*) text);

	  sConfig.Channel = ADC_CHANNEL_6;
	  HAL_ADC_ConfigChannel(&hadc3, &sConfig);
	  HAL_ADC_Start(&hadc3);
	  while(HAL_ADC_PollForConversion(&hadc3, 100)!=HAL_OK);
	  potr = HAL_ADC_GetValue(&hadc3);

	  sConfig.Channel = ADC_CHANNEL_7;
	  HAL_ADC_ConfigChannel(&hadc3, &sConfig);
	  HAL_ADC_Start(&hadc3);
	  while(HAL_ADC_PollForConversion(&hadc3, 100)!=HAL_OK);
	  potl = HAL_ADC_GetValue(&hadc3);

	  sConfig.Channel = ADC_CHANNEL_8;
	  HAL_ADC_ConfigChannel(&hadc3, &sConfig);
	  HAL_ADC_Start(&hadc3);
	  while(HAL_ADC_PollForConversion(&hadc3, 100)!=HAL_OK);
	  joystick_v = HAL_ADC_GetValue(&hadc3);

	  HAL_ADC_Start(&hadc1);
	  while(HAL_ADC_PollForConversion(&hadc1, 100)!=HAL_OK);
	  joystick_h = HAL_ADC_GetValue(&hadc1);

	  sprintf(text,"POTL : %4u POTR : %4u joy_v : %4u joy_h : %4u",(uint)potl,(uint)potr,(uint)joystick_v,(uint)joystick_h);
	  BSP_LCD_DisplayStringAtLine(9,(uint8_t*) text);

	  BSP_TS_GetState(&TS_State);
	  if(TS_State.touchDetected){
		  BSP_LCD_FillCircle(TS_State.touchX[0],TS_State.touchY[0],4);
	  }
    /* USER CODE END WHILE */

  }
}

void SystemClock_Config(void)
{
  RCC_OscInitTypeDef RCC_OscInitStruct = {0};
  RCC_ClkInitTypeDef RCC_ClkInitStruct = {0};
  RCC_PeriphCLKInitTypeDef PeriphClkInitStruct = {0};

  /** Configure LSE Drive Capability
  */
  HAL_PWR_EnableBkUpAccess();
  /** Configure the main internal regulator output voltage
  */
  __HAL_RCC_PWR_CLK_ENABLE();
  __HAL_PWR_VOLTAGESCALING_CONFIG(PWR_REGULATOR_VOLTAGE_SCALE1);
  /** Initializes the RCC Oscillators according to the specified parameters
  * in the RCC_OscInitTypeDef structure.
  */
  RCC_OscInitStruct.OscillatorType = RCC_OSCILLATORTYPE_LSI|RCC_OSCILLATORTYPE_HSE;
  RCC_OscInitStruct.HSEState = RCC_HSE_ON;
  RCC_OscInitStruct.LSIState = RCC_LSI_ON;
  RCC_OscInitStruct.PLL.PLLState = RCC_PLL_ON;
  RCC_OscInitStruct.PLL.PLLSource = RCC_PLLSOURCE_HSE;
  RCC_OscInitStruct.PLL.PLLM = 25;
  RCC_OscInitStruct.PLL.PLLN = 400;
  RCC_OscInitStruct.PLL.PLLP = RCC_PLLP_DIV2;
  RCC_OscInitStruct.PLL.PLLQ = 9;
  if (HAL_RCC_OscConfig(&RCC_OscInitStruct) != HAL_OK)
  {
    Error_Handler();
  }
  /** Activate the Over-Drive mode
  */
  if (HAL_PWREx_EnableOverDrive() != HAL_OK)
  {
    Error_Handler();
  }
  /** Initializes the CPU, AHB and APB buses clocks
  */
  RCC_ClkInitStruct.ClockType = RCC_CLOCKTYPE_HCLK|RCC_CLOCKTYPE_SYSCLK
                              |RCC_CLOCKTYPE_PCLK1|RCC_CLOCKTYPE_PCLK2;
  RCC_ClkInitStruct.SYSCLKSource = RCC_SYSCLKSOURCE_PLLCLK;
  RCC_ClkInitStruct.AHBCLKDivider = RCC_SYSCLK_DIV1;
  RCC_ClkInitStruct.APB1CLKDivider = RCC_HCLK_DIV4;
  RCC_ClkInitStruct.APB2CLKDivider = RCC_HCLK_DIV2;

  if (HAL_RCC_ClockConfig(&RCC_ClkInitStruct, FLASH_LATENCY_6) != HAL_OK)
  {
    Error_Handler();
  }
  PeriphClkInitStruct.PeriphClockSelection = RCC_PERIPHCLK_LTDC|RCC_PERIPHCLK_RTC
                              |RCC_PERIPHCLK_USART1|RCC_PERIPHCLK_USART6
                              |RCC_PERIPHCLK_UART7|RCC_PERIPHCLK_I2C1
                              |RCC_PERIPHCLK_I2C3;
  PeriphClkInitStruct.PLLSAI.PLLSAIN = 384;
  PeriphClkInitStruct.PLLSAI.PLLSAIR = 5;
  PeriphClkInitStruct.PLLSAI.PLLSAIQ = 2;
  PeriphClkInitStruct.PLLSAI.PLLSAIP = RCC_PLLSAIP_DIV8;
  PeriphClkInitStruct.PLLSAIDivQ = 1;
  PeriphClkInitStruct.PLLSAIDivR = RCC_PLLSAIDIVR_8;
  PeriphClkInitStruct.RTCClockSelection = RCC_RTCCLKSOURCE_LSI;
  PeriphClkInitStruct.Usart1ClockSelection = RCC_USART1CLKSOURCE_PCLK2;
  PeriphClkInitStruct.Usart6ClockSelection = RCC_USART6CLKSOURCE_PCLK2;
  PeriphClkInitStruct.Uart7ClockSelection = RCC_UART7CLKSOURCE_PCLK1;
  PeriphClkInitStruct.I2c1ClockSelection = RCC_I2C1CLKSOURCE_PCLK1;
  PeriphClkInitStruct.I2c3ClockSelection = RCC_I2C3CLKSOURCE_PCLK1;
  if (HAL_RCCEx_PeriphCLKConfig(&PeriphClkInitStruct) != HAL_OK)
  {
    Error_Handler();
  }
}

static void MX_ADC1_Init(void)
{

  ADC_ChannelConfTypeDef sConfig = {0};

  /** Configure the global features of the ADC (Clock, Resolution, Data Alignment and number of conversion)
  */
  hadc1.Instance = ADC1;
  hadc1.Init.ClockPrescaler = ADC_CLOCK_SYNC_PCLK_DIV4;
  hadc1.Init.Resolution = ADC_RESOLUTION_12B;
  hadc1.Init.ScanConvMode = ADC_SCAN_DISABLE;
  hadc1.Init.ContinuousConvMode = DISABLE;
  hadc1.Init.DiscontinuousConvMode = DISABLE;
  hadc1.Init.ExternalTrigConvEdge = ADC_EXTERNALTRIGCONVEDGE_NONE;
  hadc1.Init.ExternalTrigConv = ADC_SOFTWARE_START;
  hadc1.Init.DataAlign = ADC_DATAALIGN_RIGHT;
  hadc1.Init.NbrOfConversion = 1;
  hadc1.Init.DMAContinuousRequests = DISABLE;
  hadc1.Init.EOCSelection = ADC_EOC_SINGLE_CONV;
  if (HAL_ADC_Init(&hadc1) != HAL_OK)
  {
    Error_Handler();
  }
  /** Configure for the selected ADC regular channel its corresponding rank in the sequencer and its sample time.
  */
  sConfig.Channel = ADC_CHANNEL_0;
  sConfig.Rank = ADC_REGULAR_RANK_1;
  sConfig.SamplingTime = ADC_SAMPLETIME_3CYCLES;
  if (HAL_ADC_ConfigChannel(&hadc1, &sConfig) != HAL_OK)
  {
    Error_Handler();
  }

}

static void MX_ADC3_Init(void)
{

  ADC_ChannelConfTypeDef sConfig = {0};

  /** Configure the global features of the ADC (Clock, Resolution, Data Alignment and number of conversion)
  */
  hadc3.Instance = ADC3;
  hadc3.Init.ClockPrescaler = ADC_CLOCK_SYNC_PCLK_DIV4;
  hadc3.Init.Resolution = ADC_RESOLUTION_12B;
  hadc3.Init.ScanConvMode = ADC_SCAN_DISABLE;
  hadc3.Init.ContinuousConvMode = DISABLE;
  hadc3.Init.DiscontinuousConvMode = DISABLE;
  hadc3.Init.ExternalTrigConvEdge = ADC_EXTERNALTRIGCONVEDGE_NONE;
  hadc3.Init.ExternalTrigConv = ADC_SOFTWARE_START;
  hadc3.Init.DataAlign = ADC_DATAALIGN_RIGHT;
  hadc3.Init.NbrOfConversion = 1;
  hadc3.Init.DMAContinuousRequests = DISABLE;
  hadc3.Init.EOCSelection = ADC_EOC_SINGLE_CONV;
  if (HAL_ADC_Init(&hadc3) != HAL_OK)
  {
    Error_Handler();
  }
  /** Configure for the selected ADC regular channel its corresponding rank in the sequencer and its sample time.
  */
  sConfig.Channel = ADC_CHANNEL_6;
  sConfig.Rank = ADC_REGULAR_RANK_1;
  sConfig.SamplingTime = ADC_SAMPLETIME_3CYCLES;
  if (HAL_ADC_ConfigChannel(&hadc3, &sConfig) != HAL_OK)
  {
    Error_Handler();
  }

}

static void MX_DAC_Init(void)
{

  DAC_ChannelConfTypeDef sConfig = {0};

  /** DAC Initialization
  */
  hdac.Instance = DAC;
  if (HAL_DAC_Init(&hdac) != HAL_OK)
  {
    Error_Handler();
  }
  /** DAC channel OUT1 config
  */
  sConfig.DAC_Trigger = DAC_TRIGGER_NONE;
  sConfig.DAC_OutputBuffer = DAC_OUTPUTBUFFER_ENABLE;
  if (HAL_DAC_ConfigChannel(&hdac, &sConfig, DAC_CHANNEL_1) != HAL_OK)
  {
    Error_Handler();
  }

}

static void MX_DMA2D_Init(void)
{

  hdma2d.Instance = DMA2D;
  hdma2d.Init.Mode = DMA2D_M2M;
  hdma2d.Init.ColorMode = DMA2D_OUTPUT_ARGB8888;
  hdma2d.Init.OutputOffset = 0;
  hdma2d.LayerCfg[1].InputOffset = 0;
  hdma2d.LayerCfg[1].InputColorMode = DMA2D_INPUT_ARGB8888;
  hdma2d.LayerCfg[1].AlphaMode = DMA2D_NO_MODIF_ALPHA;
  hdma2d.LayerCfg[1].InputAlpha = 0;
  if (HAL_DMA2D_Init(&hdma2d) != HAL_OK)
  {
    Error_Handler();
  }
  if (HAL_DMA2D_ConfigLayer(&hdma2d, 1) != HAL_OK)
  {
    Error_Handler();
  }

}

static void MX_I2C1_Init(void)
{

  hi2c1.Instance = I2C1;
  hi2c1.Init.Timing = 0x00C0EAFF;
  hi2c1.Init.OwnAddress1 = 0;
  hi2c1.Init.AddressingMode = I2C_ADDRESSINGMODE_7BIT;
  hi2c1.Init.DualAddressMode = I2C_DUALADDRESS_DISABLE;
  hi2c1.Init.OwnAddress2 = 0;
  hi2c1.Init.OwnAddress2Masks = I2C_OA2_NOMASK;
  hi2c1.Init.GeneralCallMode = I2C_GENERALCALL_DISABLE;
  hi2c1.Init.NoStretchMode = I2C_NOSTRETCH_DISABLE;
  if (HAL_I2C_Init(&hi2c1) != HAL_OK)
  {
    Error_Handler();
  }
  /** Configure Analogue filter
  */
  if (HAL_I2CEx_ConfigAnalogFilter(&hi2c1, I2C_ANALOGFILTER_ENABLE) != HAL_OK)
  {
    Error_Handler();
  }
  /** Configure Digital filter
  */
  if (HAL_I2CEx_ConfigDigitalFilter(&hi2c1, 0) != HAL_OK)
  {
    Error_Handler();
  }

}

static void MX_I2C3_Init(void)
{

  hi2c3.Instance = I2C3;
  hi2c3.Init.Timing = 0x00C0EAFF;
  hi2c3.Init.OwnAddress1 = 0;
  hi2c3.Init.AddressingMode = I2C_ADDRESSINGMODE_7BIT;
  hi2c3.Init.DualAddressMode = I2C_DUALADDRESS_DISABLE;
  hi2c3.Init.OwnAddress2 = 0;
  hi2c3.Init.OwnAddress2Masks = I2C_OA2_NOMASK;
  hi2c3.Init.GeneralCallMode = I2C_GENERALCALL_DISABLE;
  hi2c3.Init.NoStretchMode = I2C_NOSTRETCH_DISABLE;
  if (HAL_I2C_Init(&hi2c3) != HAL_OK)
  {
    Error_Handler();
  }
  /** Configure Analogue filter
  */
  if (HAL_I2CEx_ConfigAnalogFilter(&hi2c3, I2C_ANALOGFILTER_ENABLE) != HAL_OK)
  {
    Error_Handler();
  }
  /** Configure Digital filter
  */
  if (HAL_I2CEx_ConfigDigitalFilter(&hi2c3, 0) != HAL_OK)
  {
    Error_Handler();
  }

}

static void MX_LTDC_Init(void)
{

  LTDC_LayerCfgTypeDef pLayerCfg = {0};

  hltdc.Instance = LTDC;
  hltdc.Init.HSPolarity = LTDC_HSPOLARITY_AL;
  hltdc.Init.VSPolarity = LTDC_VSPOLARITY_AL;
  hltdc.Init.DEPolarity = LTDC_DEPOLARITY_AL;
  hltdc.Init.PCPolarity = LTDC_PCPOLARITY_IPC;
  hltdc.Init.HorizontalSync = 40;
  hltdc.Init.VerticalSync = 9;
  hltdc.Init.AccumulatedHBP = 53;
  hltdc.Init.AccumulatedVBP = 11;
  hltdc.Init.AccumulatedActiveW = 533;
  hltdc.Init.AccumulatedActiveH = 283;
  hltdc.Init.TotalWidth = 565;
  hltdc.Init.TotalHeigh = 285;
  hltdc.Init.Backcolor.Blue = 0;
  hltdc.Init.Backcolor.Green = 0;
  hltdc.Init.Backcolor.Red = 0;
  if (HAL_LTDC_Init(&hltdc) != HAL_OK)
  {
    Error_Handler();
  }
  pLayerCfg.WindowX0 = 0;
  pLayerCfg.WindowX1 = 480;
  pLayerCfg.WindowY0 = 0;
  pLayerCfg.WindowY1 = 272;
  pLayerCfg.PixelFormat = LTDC_PIXEL_FORMAT_RGB565;
  pLayerCfg.Alpha = 255;
  pLayerCfg.Alpha0 = 0;
  pLayerCfg.BlendingFactor1 = LTDC_BLENDING_FACTOR1_PAxCA;
  pLayerCfg.BlendingFactor2 = LTDC_BLENDING_FACTOR2_PAxCA;
  pLayerCfg.FBStartAdress = 0xC0000000;
  pLayerCfg.ImageWidth = 480;
  pLayerCfg.ImageHeight = 272;
  pLayerCfg.Backcolor.Blue = 0;
  pLayerCfg.Backcolor.Green = 0;
  pLayerCfg.Backcolor.Red = 0;
  if (HAL_LTDC_ConfigLayer(&hltdc, &pLayerCfg, 0) != HAL_OK)
  {
    Error_Handler();
  }

}

static void MX_RTC_Init(void)
{

  RTC_TimeTypeDef sTime = {0};
  RTC_DateTypeDef sDate = {0};
  RTC_AlarmTypeDef sAlarm = {0};

  /** Initialize RTC Only
  */
  hrtc.Instance = RTC;
  hrtc.Init.HourFormat = RTC_HOURFORMAT_24;
  hrtc.Init.AsynchPrediv = 127;
  hrtc.Init.SynchPrediv = 255;
  hrtc.Init.OutPut = RTC_OUTPUT_DISABLE;
  hrtc.Init.OutPutPolarity = RTC_OUTPUT_POLARITY_HIGH;
  hrtc.Init.OutPutType = RTC_OUTPUT_TYPE_OPENDRAIN;
  if (HAL_RTC_Init(&hrtc) != HAL_OK)
  {
    Error_Handler();
  }

  /** Initialize RTC and set the Time and Date
  */
  sTime.Hours = 0x0;
  sTime.Minutes = 0x0;
  sTime.Seconds = 0x0;
  sTime.DayLightSaving = RTC_DAYLIGHTSAVING_NONE;
  sTime.StoreOperation = RTC_STOREOPERATION_RESET;
  if (HAL_RTC_SetTime(&hrtc, &sTime, RTC_FORMAT_BCD) != HAL_OK)
  {
    Error_Handler();
  }
  sDate.WeekDay = RTC_WEEKDAY_MONDAY;
  sDate.Month = RTC_MONTH_JANUARY;
  sDate.Date = 0x1;
  sDate.Year = 0x0;
  if (HAL_RTC_SetDate(&hrtc, &sDate, RTC_FORMAT_BCD) != HAL_OK)
  {
    Error_Handler();
  }
  /** Enable the Alarm A
  */
  sAlarm.AlarmTime.Hours = 0x0;
  sAlarm.AlarmTime.Minutes = 0x0;
  sAlarm.AlarmTime.Seconds = 0x0;
  sAlarm.AlarmTime.SubSeconds = 0x0;
  sAlarm.AlarmTime.DayLightSaving = RTC_DAYLIGHTSAVING_NONE;
  sAlarm.AlarmTime.StoreOperation = RTC_STOREOPERATION_RESET;
  sAlarm.AlarmMask = RTC_ALARMMASK_NONE;
  sAlarm.AlarmSubSecondMask = RTC_ALARMSUBSECONDMASK_ALL;
  sAlarm.AlarmDateWeekDaySel = RTC_ALARMDATEWEEKDAYSEL_DATE;
  sAlarm.AlarmDateWeekDay = 0x1;
  sAlarm.Alarm = RTC_ALARM_A;
  if (HAL_RTC_SetAlarm(&hrtc, &sAlarm, RTC_FORMAT_BCD) != HAL_OK)
  {
    Error_Handler();
  }
  /** Enable the Alarm B
  */
  sAlarm.Alarm = RTC_ALARM_B;
  if (HAL_RTC_SetAlarm(&hrtc, &sAlarm, RTC_FORMAT_BCD) != HAL_OK)
  {
    Error_Handler();
  }
  /** Enable the TimeStamp
  */
  if (HAL_RTCEx_SetTimeStamp(&hrtc, RTC_TIMESTAMPEDGE_RISING, RTC_TIMESTAMPPIN_POS1) != HAL_OK)
  {
    Error_Handler();
  }

}

static void MX_SPI2_Init(void)
{

  /* SPI2 parameter configuration*/
  hspi2.Instance = SPI2;
  hspi2.Init.Mode = SPI_MODE_MASTER;
  hspi2.Init.Direction = SPI_DIRECTION_2LINES;
  hspi2.Init.DataSize = SPI_DATASIZE_4BIT;
  hspi2.Init.CLKPolarity = SPI_POLARITY_LOW;
  hspi2.Init.CLKPhase = SPI_PHASE_1EDGE;
  hspi2.Init.NSS = SPI_NSS_HARD_OUTPUT;
  hspi2.Init.BaudRatePrescaler = SPI_BAUDRATEPRESCALER_2;
  hspi2.Init.FirstBit = SPI_FIRSTBIT_MSB;
  hspi2.Init.TIMode = SPI_TIMODE_DISABLE;
  hspi2.Init.CRCCalculation = SPI_CRCCALCULATION_DISABLE;
  hspi2.Init.CRCPolynomial = 7;
  hspi2.Init.CRCLength = SPI_CRC_LENGTH_DATASIZE;
  hspi2.Init.NSSPMode = SPI_NSS_PULSE_ENABLE;
  if (HAL_SPI_Init(&hspi2) != HAL_OK)
  {
    Error_Handler();
  }

}

static void MX_TIM1_Init(void)
{

  TIM_ClockConfigTypeDef sClockSourceConfig = {0};
  TIM_MasterConfigTypeDef sMasterConfig = {0};

  htim1.Instance = TIM1;
  htim1.Init.Prescaler = 0;
  htim1.Init.CounterMode = TIM_COUNTERMODE_UP;
  htim1.Init.Period = 65535;
  htim1.Init.ClockDivision = TIM_CLOCKDIVISION_DIV1;
  htim1.Init.RepetitionCounter = 0;
  htim1.Init.AutoReloadPreload = TIM_AUTORELOAD_PRELOAD_DISABLE;
  if (HAL_TIM_Base_Init(&htim1) != HAL_OK)
  {
    Error_Handler();
  }
  sClockSourceConfig.ClockSource = TIM_CLOCKSOURCE_INTERNAL;
  if (HAL_TIM_ConfigClockSource(&htim1, &sClockSourceConfig) != HAL_OK)
  {
    Error_Handler();
  }
  sMasterConfig.MasterOutputTrigger = TIM_TRGO_RESET;
  sMasterConfig.MasterOutputTrigger2 = TIM_TRGO2_RESET;
  sMasterConfig.MasterSlaveMode = TIM_MASTERSLAVEMODE_DISABLE;
  if (HAL_TIMEx_MasterConfigSynchronization(&htim1, &sMasterConfig) != HAL_OK)
  {
    Error_Handler();
  }

}

static void MX_TIM2_Init(void)
{

  TIM_ClockConfigTypeDef sClockSourceConfig = {0};
  TIM_MasterConfigTypeDef sMasterConfig = {0};

  htim2.Instance = TIM2;
  htim2.Init.Prescaler = 0;
  htim2.Init.CounterMode = TIM_COUNTERMODE_UP;
  htim2.Init.Period = 4294967295;
  htim2.Init.ClockDivision = TIM_CLOCKDIVISION_DIV1;
  htim2.Init.AutoReloadPreload = TIM_AUTORELOAD_PRELOAD_DISABLE;
  if (HAL_TIM_Base_Init(&htim2) != HAL_OK)
  {
    Error_Handler();
  }
  sClockSourceConfig.ClockSource = TIM_CLOCKSOURCE_INTERNAL;
  if (HAL_TIM_ConfigClockSource(&htim2, &sClockSourceConfig) != HAL_OK)
  {
    Error_Handler();
  }
  sMasterConfig.MasterOutputTrigger = TIM_TRGO_RESET;
  sMasterConfig.MasterSlaveMode = TIM_MASTERSLAVEMODE_DISABLE;
  if (HAL_TIMEx_MasterConfigSynchronization(&htim2, &sMasterConfig) != HAL_OK)
  {
    Error_Handler();
  }

}

static void MX_TIM3_Init(void)
{

  TIM_ClockConfigTypeDef sClockSourceConfig = {0};
  TIM_SlaveConfigTypeDef sSlaveConfig = {0};
  TIM_MasterConfigTypeDef sMasterConfig = {0};
  TIM_OC_InitTypeDef sConfigOC = {0};

  htim3.Instance = TIM3;
  htim3.Init.Prescaler = 0;
  htim3.Init.CounterMode = TIM_COUNTERMODE_UP;
  htim3.Init.Period = 65535;
  htim3.Init.ClockDivision = TIM_CLOCKDIVISION_DIV1;
  htim3.Init.AutoReloadPreload = TIM_AUTORELOAD_PRELOAD_DISABLE;
  if (HAL_TIM_Base_Init(&htim3) != HAL_OK)
  {
    Error_Handler();
  }
  sClockSourceConfig.ClockSource = TIM_CLOCKSOURCE_INTERNAL;
  if (HAL_TIM_ConfigClockSource(&htim3, &sClockSourceConfig) != HAL_OK)
  {
    Error_Handler();
  }
  if (HAL_TIM_PWM_Init(&htim3) != HAL_OK)
  {
    Error_Handler();
  }
  sSlaveConfig.SlaveMode = TIM_SLAVEMODE_DISABLE;
  sSlaveConfig.InputTrigger = TIM_TS_ITR0;
  if (HAL_TIM_SlaveConfigSynchro(&htim3, &sSlaveConfig) != HAL_OK)
  {
    Error_Handler();
  }
  sMasterConfig.MasterOutputTrigger = TIM_TRGO_RESET;
  sMasterConfig.MasterSlaveMode = TIM_MASTERSLAVEMODE_DISABLE;
  if (HAL_TIMEx_MasterConfigSynchronization(&htim3, &sMasterConfig) != HAL_OK)
  {
    Error_Handler();
  }
  sConfigOC.OCMode = TIM_OCMODE_PWM1;
  sConfigOC.Pulse = 0;
  sConfigOC.OCPolarity = TIM_OCPOLARITY_HIGH;
  sConfigOC.OCFastMode = TIM_OCFAST_DISABLE;
  if (HAL_TIM_PWM_ConfigChannel(&htim3, &sConfigOC, TIM_CHANNEL_1) != HAL_OK)
  {
    Error_Handler();
  }
  HAL_TIM_MspPostInit(&htim3);

}

static void MX_TIM5_Init(void)
{

  TIM_ClockConfigTypeDef sClockSourceConfig = {0};
  TIM_MasterConfigTypeDef sMasterConfig = {0};

  htim5.Instance = TIM5;
  htim5.Init.Prescaler = 0;
  htim5.Init.CounterMode = TIM_COUNTERMODE_UP;
  htim5.Init.Period = 4294967295;
  htim5.Init.ClockDivision = TIM_CLOCKDIVISION_DIV1;
  htim5.Init.AutoReloadPreload = TIM_AUTORELOAD_PRELOAD_DISABLE;
  if (HAL_TIM_Base_Init(&htim5) != HAL_OK)
  {
    Error_Handler();
  }
  sClockSourceConfig.ClockSource = TIM_CLOCKSOURCE_INTERNAL;
  if (HAL_TIM_ConfigClockSource(&htim5, &sClockSourceConfig) != HAL_OK)
  {
    Error_Handler();
  }
  sMasterConfig.MasterOutputTrigger = TIM_TRGO_RESET;
  sMasterConfig.MasterSlaveMode = TIM_MASTERSLAVEMODE_DISABLE;
  if (HAL_TIMEx_MasterConfigSynchronization(&htim5, &sMasterConfig) != HAL_OK)
  {
    Error_Handler();
  }

}

static void MX_TIM8_Init(void)
{

  TIM_ClockConfigTypeDef sClockSourceConfig = {0};
  TIM_MasterConfigTypeDef sMasterConfig = {0};
  TIM_OC_InitTypeDef sConfigOC = {0};
  TIM_BreakDeadTimeConfigTypeDef sBreakDeadTimeConfig = {0};

  htim8.Instance = TIM8;
  htim8.Init.Prescaler = 0;
  htim8.Init.CounterMode = TIM_COUNTERMODE_UP;
  htim8.Init.Period = 65535;
  htim8.Init.ClockDivision = TIM_CLOCKDIVISION_DIV1;
  htim8.Init.RepetitionCounter = 0;
  htim8.Init.AutoReloadPreload = TIM_AUTORELOAD_PRELOAD_DISABLE;
  if (HAL_TIM_Base_Init(&htim8) != HAL_OK)
  {
    Error_Handler();
  }
  sClockSourceConfig.ClockSource = TIM_CLOCKSOURCE_INTERNAL;
  if (HAL_TIM_ConfigClockSource(&htim8, &sClockSourceConfig) != HAL_OK)
  {
    Error_Handler();
  }
  if (HAL_TIM_PWM_Init(&htim8) != HAL_OK)
  {
    Error_Handler();
  }
  sMasterConfig.MasterOutputTrigger = TIM_TRGO_RESET;
  sMasterConfig.MasterOutputTrigger2 = TIM_TRGO2_RESET;
  sMasterConfig.MasterSlaveMode = TIM_MASTERSLAVEMODE_DISABLE;
  if (HAL_TIMEx_MasterConfigSynchronization(&htim8, &sMasterConfig) != HAL_OK)
  {
    Error_Handler();
  }
  sConfigOC.OCMode = TIM_OCMODE_PWM1;
  sConfigOC.Pulse = 0;
  sConfigOC.OCPolarity = TIM_OCPOLARITY_HIGH;
  sConfigOC.OCFastMode = TIM_OCFAST_DISABLE;
  sConfigOC.OCIdleState = TIM_OCIDLESTATE_RESET;
  sConfigOC.OCNIdleState = TIM_OCNIDLESTATE_RESET;
  if (HAL_TIM_PWM_ConfigChannel(&htim8, &sConfigOC, TIM_CHANNEL_4) != HAL_OK)
  {
    Error_Handler();
  }
  sBreakDeadTimeConfig.OffStateRunMode = TIM_OSSR_DISABLE;
  sBreakDeadTimeConfig.OffStateIDLEMode = TIM_OSSI_DISABLE;
  sBreakDeadTimeConfig.LockLevel = TIM_LOCKLEVEL_OFF;
  sBreakDeadTimeConfig.DeadTime = 0;
  sBreakDeadTimeConfig.BreakState = TIM_BREAK_DISABLE;
  sBreakDeadTimeConfig.BreakPolarity = TIM_BREAKPOLARITY_HIGH;
  sBreakDeadTimeConfig.BreakFilter = 0;
  sBreakDeadTimeConfig.Break2State = TIM_BREAK2_DISABLE;
  sBreakDeadTimeConfig.Break2Polarity = TIM_BREAK2POLARITY_HIGH;
  sBreakDeadTimeConfig.Break2Filter = 0;
  sBreakDeadTimeConfig.AutomaticOutput = TIM_AUTOMATICOUTPUT_DISABLE;
  if (HAL_TIMEx_ConfigBreakDeadTime(&htim8, &sBreakDeadTimeConfig) != HAL_OK)
  {
    Error_Handler();
  }
  HAL_TIM_MspPostInit(&htim8);

}

static void MX_UART7_Init(void)
{

  huart7.Instance = UART7;
  huart7.Init.BaudRate = 115200;
  huart7.Init.WordLength = UART_WORDLENGTH_8B;
  huart7.Init.StopBits = UART_STOPBITS_1;
  huart7.Init.Parity = UART_PARITY_NONE;
  huart7.Init.Mode = UART_MODE_TX_RX;
  huart7.Init.HwFlowCtl = UART_HWCONTROL_NONE;
  huart7.Init.OverSampling = UART_OVERSAMPLING_16;
  huart7.Init.OneBitSampling = UART_ONE_BIT_SAMPLE_DISABLE;
  huart7.AdvancedInit.AdvFeatureInit = UART_ADVFEATURE_NO_INIT;
  if (HAL_UART_Init(&huart7) != HAL_OK)
  {
    Error_Handler();
  }

}

static void MX_USART1_UART_Init(void)
{

  huart1.Instance = USART1;
  huart1.Init.BaudRate = 115200;
  huart1.Init.WordLength = UART_WORDLENGTH_8B;
  huart1.Init.StopBits = UART_STOPBITS_1;
  huart1.Init.Parity = UART_PARITY_NONE;
  huart1.Init.Mode = UART_MODE_TX_RX;
  huart1.Init.HwFlowCtl = UART_HWCONTROL_NONE;
  huart1.Init.OverSampling = UART_OVERSAMPLING_16;
  huart1.Init.OneBitSampling = UART_ONE_BIT_SAMPLE_DISABLE;
  huart1.AdvancedInit.AdvFeatureInit = UART_ADVFEATURE_NO_INIT;
  if (HAL_UART_Init(&huart1) != HAL_OK)
  {
    Error_Handler();
  }

}

static void MX_USART6_UART_Init(void)
{

  huart6.Instance = USART6;
  huart6.Init.BaudRate = 115200;
  huart6.Init.WordLength = UART_WORDLENGTH_8B;
  huart6.Init.StopBits = UART_STOPBITS_1;
  huart6.Init.Parity = UART_PARITY_NONE;
  huart6.Init.Mode = UART_MODE_TX_RX;
  huart6.Init.HwFlowCtl = UART_HWCONTROL_NONE;
  huart6.Init.OverSampling = UART_OVERSAMPLING_16;
  huart6.Init.OneBitSampling = UART_ONE_BIT_SAMPLE_DISABLE;
  huart6.AdvancedInit.AdvFeatureInit = UART_ADVFEATURE_NO_INIT;
  if (HAL_UART_Init(&huart6) != HAL_OK)
  {
    Error_Handler();
  }

}

/* FMC initialization function */
static void MX_FMC_Init(void)
{

  FMC_SDRAM_TimingTypeDef SdramTiming = {0};

  /** Perform the SDRAM1 memory initialization sequence
  */
  hsdram1.Instance = FMC_SDRAM_DEVICE;
  /* hsdram1.Init */
  hsdram1.Init.SDBank = FMC_SDRAM_BANK1;
  hsdram1.Init.ColumnBitsNumber = FMC_SDRAM_COLUMN_BITS_NUM_8;
  hsdram1.Init.RowBitsNumber = FMC_SDRAM_ROW_BITS_NUM_12;
  hsdram1.Init.MemoryDataWidth = FMC_SDRAM_MEM_BUS_WIDTH_16;
  hsdram1.Init.InternalBankNumber = FMC_SDRAM_INTERN_BANKS_NUM_4;
  hsdram1.Init.CASLatency = FMC_SDRAM_CAS_LATENCY_1;
  hsdram1.Init.WriteProtection = FMC_SDRAM_WRITE_PROTECTION_DISABLE;
  hsdram1.Init.SDClockPeriod = FMC_SDRAM_CLOCK_DISABLE;
  hsdram1.Init.ReadBurst = FMC_SDRAM_RBURST_DISABLE;
  hsdram1.Init.ReadPipeDelay = FMC_SDRAM_RPIPE_DELAY_0;
  /* SdramTiming */
  SdramTiming.LoadToActiveDelay = 16;
  SdramTiming.ExitSelfRefreshDelay = 16;
  SdramTiming.SelfRefreshTime = 16;
  SdramTiming.RowCycleDelay = 16;
  SdramTiming.WriteRecoveryTime = 16;
  SdramTiming.RPDelay = 16;
  SdramTiming.RCDDelay = 16;

  if (HAL_SDRAM_Init(&hsdram1, &SdramTiming) != HAL_OK)
  {
    Error_Handler( );
  }

}

static void MX_GPIO_Init(void)
{
  GPIO_InitTypeDef GPIO_InitStruct = {0};

  /* GPIO Ports Clock Enable */
  __HAL_RCC_GPIOE_CLK_ENABLE();
  __HAL_RCC_GPIOB_CLK_ENABLE();
  __HAL_RCC_GPIOA_CLK_ENABLE();
  __HAL_RCC_GPIOG_CLK_ENABLE();
  __HAL_RCC_GPIOJ_CLK_ENABLE();
  __HAL_RCC_GPIOD_CLK_ENABLE();
  __HAL_RCC_GPIOI_CLK_ENABLE();
  __HAL_RCC_GPIOK_CLK_ENABLE();
  __HAL_RCC_GPIOC_CLK_ENABLE();
  __HAL_RCC_GPIOF_CLK_ENABLE();
  __HAL_RCC_GPIOH_CLK_ENABLE();

  /*Configure GPIO pin Output Level */
  HAL_GPIO_WritePin(GPIOE, LED14_Pin|LED15_Pin, GPIO_PIN_RESET);

  /*Configure GPIO pin Output Level */
  HAL_GPIO_WritePin(OTG_FS_PowerSwitchOn_GPIO_Port, OTG_FS_PowerSwitchOn_Pin, GPIO_PIN_SET);

  /*Configure GPIO pin Output Level */
  HAL_GPIO_WritePin(LED16_GPIO_Port, LED16_Pin, GPIO_PIN_RESET);

  /*Configure GPIO pin Output Level */
  HAL_GPIO_WritePin(LED3_GPIO_Port, LED3_Pin, GPIO_PIN_RESET);

  /*Configure GPIO pin Output Level */
  HAL_GPIO_WritePin(LCD_BL_CTRL_GPIO_Port, LCD_BL_CTRL_Pin, GPIO_PIN_SET);

  /*Configure GPIO pin Output Level */
  HAL_GPIO_WritePin(LCD_DISP_GPIO_Port, LCD_DISP_Pin, GPIO_PIN_SET);

  /*Configure GPIO pin Output Level */
  HAL_GPIO_WritePin(GPIOH, LED13_Pin|LED17_Pin|LED11_Pin|LED12_Pin
                          |LED2_Pin|LED18_Pin, GPIO_PIN_RESET);

  /*Configure GPIO pin Output Level */
  HAL_GPIO_WritePin(EXT_RST_GPIO_Port, EXT_RST_Pin, GPIO_PIN_RESET);

  /*Configure GPIO pin : PE3 */
  GPIO_InitStruct.Pin = GPIO_PIN_3;
  GPIO_InitStruct.Mode = GPIO_MODE_INPUT;
  GPIO_InitStruct.Pull = GPIO_NOPULL;
  HAL_GPIO_Init(GPIOE, &GPIO_InitStruct);

  /*Configure GPIO pins : ULPI_D7_Pin ULPI_D6_Pin ULPI_D5_Pin ULPI_D2_Pin
                           ULPI_D1_Pin ULPI_D4_Pin */
  GPIO_InitStruct.Pin = ULPI_D7_Pin|ULPI_D6_Pin|ULPI_D5_Pin|ULPI_D2_Pin
                          |ULPI_D1_Pin|ULPI_D4_Pin;
  GPIO_InitStruct.Mode = GPIO_MODE_AF_PP;
  GPIO_InitStruct.Pull = GPIO_NOPULL;
  GPIO_InitStruct.Speed = GPIO_SPEED_FREQ_VERY_HIGH;
  GPIO_InitStruct.Alternate = GPIO_AF10_OTG_HS;
  HAL_GPIO_Init(GPIOB, &GPIO_InitStruct);

  /*Configure GPIO pins : BP2_Pin BP1_Pin */
  GPIO_InitStruct.Pin = BP2_Pin|BP1_Pin;
  GPIO_InitStruct.Mode = GPIO_MODE_IT_RISING;
  GPIO_InitStruct.Pull = GPIO_NOPULL;
  HAL_GPIO_Init(GPIOA, &GPIO_InitStruct);

  /*Configure GPIO pins : LED14_Pin LED15_Pin */
  GPIO_InitStruct.Pin = LED14_Pin|LED15_Pin;
  GPIO_InitStruct.Mode = GPIO_MODE_OUTPUT_PP;
  GPIO_InitStruct.Pull = GPIO_NOPULL;
  GPIO_InitStruct.Speed = GPIO_SPEED_FREQ_LOW;
  HAL_GPIO_Init(GPIOE, &GPIO_InitStruct);

  /*Configure GPIO pin : OTG_FS_VBUS_Pin */
  GPIO_InitStruct.Pin = OTG_FS_VBUS_Pin;
  GPIO_InitStruct.Mode = GPIO_MODE_INPUT;
  GPIO_InitStruct.Pull = GPIO_NOPULL;
  HAL_GPIO_Init(OTG_FS_VBUS_GPIO_Port, &GPIO_InitStruct);

  /*Configure GPIO pin : Audio_INT_Pin */
  GPIO_InitStruct.Pin = Audio_INT_Pin;
  GPIO_InitStruct.Mode = GPIO_MODE_EVT_RISING;
  GPIO_InitStruct.Pull = GPIO_NOPULL;
  HAL_GPIO_Init(Audio_INT_GPIO_Port, &GPIO_InitStruct);

  /*Configure GPIO pins : OTG_FS_PowerSwitchOn_Pin LED16_Pin */
  GPIO_InitStruct.Pin = OTG_FS_PowerSwitchOn_Pin|LED16_Pin;
  GPIO_InitStruct.Mode = GPIO_MODE_OUTPUT_PP;
  GPIO_InitStruct.Pull = GPIO_NOPULL;
  GPIO_InitStruct.Speed = GPIO_SPEED_FREQ_LOW;
  HAL_GPIO_Init(GPIOD, &GPIO_InitStruct);

  /*Configure GPIO pins : LED3_Pin LCD_DISP_Pin */
  GPIO_InitStruct.Pin = LED3_Pin|LCD_DISP_Pin;
  GPIO_InitStruct.Mode = GPIO_MODE_OUTPUT_PP;
  GPIO_InitStruct.Pull = GPIO_NOPULL;
  GPIO_InitStruct.Speed = GPIO_SPEED_FREQ_LOW;
  HAL_GPIO_Init(GPIOI, &GPIO_InitStruct);

  /*Configure GPIO pin : uSD_Detect_Pin */
  GPIO_InitStruct.Pin = uSD_Detect_Pin;
  GPIO_InitStruct.Mode = GPIO_MODE_INPUT;
  GPIO_InitStruct.Pull = GPIO_NOPULL;
  HAL_GPIO_Init(uSD_Detect_GPIO_Port, &GPIO_InitStruct);

  /*Configure GPIO pin : LCD_BL_CTRL_Pin */
  GPIO_InitStruct.Pin = LCD_BL_CTRL_Pin;
  GPIO_InitStruct.Mode = GPIO_MODE_OUTPUT_PP;
  GPIO_InitStruct.Pull = GPIO_NOPULL;
  GPIO_InitStruct.Speed = GPIO_SPEED_FREQ_LOW;
  HAL_GPIO_Init(LCD_BL_CTRL_GPIO_Port, &GPIO_InitStruct);

  /*Configure GPIO pin : OTG_FS_OverCurrent_Pin */
  GPIO_InitStruct.Pin = OTG_FS_OverCurrent_Pin;
  GPIO_InitStruct.Mode = GPIO_MODE_INPUT;
  GPIO_InitStruct.Pull = GPIO_NOPULL;
  HAL_GPIO_Init(OTG_FS_OverCurrent_GPIO_Port, &GPIO_InitStruct);

  /*Configure GPIO pins : TP3_Pin NC2_Pin */
  GPIO_InitStruct.Pin = TP3_Pin|NC2_Pin;
  GPIO_InitStruct.Mode = GPIO_MODE_INPUT;
  GPIO_InitStruct.Pull = GPIO_NOPULL;
  HAL_GPIO_Init(GPIOH, &GPIO_InitStruct);

  /*Configure GPIO pins : LED13_Pin LED17_Pin LED11_Pin LED12_Pin
                           LED2_Pin LED18_Pin */
  GPIO_InitStruct.Pin = LED13_Pin|LED17_Pin|LED11_Pin|LED12_Pin
                          |LED2_Pin|LED18_Pin;
  GPIO_InitStruct.Mode = GPIO_MODE_OUTPUT_PP;
  GPIO_InitStruct.Pull = GPIO_NOPULL;
  GPIO_InitStruct.Speed = GPIO_SPEED_FREQ_LOW;
  HAL_GPIO_Init(GPIOH, &GPIO_InitStruct);

  /*Configure GPIO pin : LCD_INT_Pin */
  GPIO_InitStruct.Pin = LCD_INT_Pin;
  GPIO_InitStruct.Mode = GPIO_MODE_EVT_RISING;
  GPIO_InitStruct.Pull = GPIO_NOPULL;
  HAL_GPIO_Init(LCD_INT_GPIO_Port, &GPIO_InitStruct);

  /*Configure GPIO pin : ULPI_NXT_Pin */
  GPIO_InitStruct.Pin = ULPI_NXT_Pin;
  GPIO_InitStruct.Mode = GPIO_MODE_AF_PP;
  GPIO_InitStruct.Pull = GPIO_NOPULL;
  GPIO_InitStruct.Speed = GPIO_SPEED_FREQ_VERY_HIGH;
  GPIO_InitStruct.Alternate = GPIO_AF10_OTG_HS;
  HAL_GPIO_Init(ULPI_NXT_GPIO_Port, &GPIO_InitStruct);

  /*Configure GPIO pin : BP_joystick_Pin */
  GPIO_InitStruct.Pin = BP_joystick_Pin;
  GPIO_InitStruct.Mode = GPIO_MODE_IT_RISING;
  GPIO_InitStruct.Pull = GPIO_NOPULL;
  HAL_GPIO_Init(BP_joystick_GPIO_Port, &GPIO_InitStruct);

  /*Configure GPIO pins : ULPI_STP_Pin ULPI_DIR_Pin */
  GPIO_InitStruct.Pin = ULPI_STP_Pin|ULPI_DIR_Pin;
  GPIO_InitStruct.Mode = GPIO_MODE_AF_PP;
  GPIO_InitStruct.Pull = GPIO_NOPULL;
  GPIO_InitStruct.Speed = GPIO_SPEED_FREQ_VERY_HIGH;
  GPIO_InitStruct.Alternate = GPIO_AF10_OTG_HS;
  HAL_GPIO_Init(GPIOC, &GPIO_InitStruct);

  /*Configure GPIO pin : EXT_RST_Pin */
  GPIO_InitStruct.Pin = EXT_RST_Pin;
  GPIO_InitStruct.Mode = GPIO_MODE_OUTPUT_PP;
  GPIO_InitStruct.Pull = GPIO_NOPULL;
  GPIO_InitStruct.Speed = GPIO_SPEED_FREQ_LOW;
  HAL_GPIO_Init(EXT_RST_GPIO_Port, &GPIO_InitStruct);

  /*Configure GPIO pin : RMII_RXER_Pin */
  GPIO_InitStruct.Pin = RMII_RXER_Pin;
  GPIO_InitStruct.Mode = GPIO_MODE_INPUT;
  GPIO_InitStruct.Pull = GPIO_NOPULL;
  HAL_GPIO_Init(RMII_RXER_GPIO_Port, &GPIO_InitStruct);

  /*Configure GPIO pins : ULPI_CLK_Pin ULPI_D0_Pin */
  GPIO_InitStruct.Pin = ULPI_CLK_Pin|ULPI_D0_Pin;
  GPIO_InitStruct.Mode = GPIO_MODE_AF_PP;
  GPIO_InitStruct.Pull = GPIO_NOPULL;
  GPIO_InitStruct.Speed = GPIO_SPEED_FREQ_VERY_HIGH;
  GPIO_InitStruct.Alternate = GPIO_AF10_OTG_HS;
  HAL_GPIO_Init(GPIOA, &GPIO_InitStruct);

  /* EXTI interrupt init*/
  HAL_NVIC_SetPriority(EXTI9_5_IRQn, 5, 0);
  HAL_NVIC_EnableIRQ(EXTI9_5_IRQn);

  HAL_NVIC_SetPriority(EXTI15_10_IRQn, 5, 0);
  HAL_NVIC_EnableIRQ(EXTI15_10_IRQn);

}

/* USER CODE BEGIN 4 */
void HAL_UART_RxCpltCallback(UART_HandleTypeDef *huart)
{
HAL_GPIO_WritePin(LED14_GPIO_Port,LED14_Pin,1);
HAL_UART_Receive_IT(&huart1,rxbuffer,1);
HAL_GPIO_WritePin(LED14_GPIO_Port,LED14_Pin,0);
}

/*
 * Fonction d'interuption
 */
void HAL_GPIO_EXTI_Callback(uint16_t GPIO_Pin)
{
	// PIN_7 : appuie joystick, on passe au menu sélectionné
	if(GPIO_Pin == GPIO_PIN_7) etat = etat_int;
	// PIN_8 : appuie bouton 1, on démarre l'enregistrement sur PC
	else if(GPIO_Pin==GPIO_PIN_8) etat = 8;
	// PIN_15 : appuie sur le bouton 2, on clear l'écran de dessin
	else if(GPIO_Pin==GPIO_PIN_15) etat = 7;
}

/* TestConditionBord*/
/*
test les condition de bord en un point pour ne pas ecrire
hors de l'écran.
*/
char TestConditionBord(uint16_t x, uint16_t y, uint16_t rad)
{
	char bool = 0;
	if(((x-rad)>=0) && ((x+rad)<=480-5-taille_menu) && ((y-rad)>=0) && ((y+rad)<246))
	{
		bool = 1;
	}
	return bool;
}
/*
 * dessine la forme du pinceau actuel pour la zone de dessin
 */
void LCD_PAINTBRUSH(uint16_t x, uint16_t y,uint16_t rad)
{
	uint32_t px_color;
	switch(brush)
	{
	case 0 :
		BSP_LCD_FillCircle(x, y, rad);
		break;
	case 1 :
		BSP_LCD_FillRect(0, 0, 425, 246);
		break;
	case 2 :
		px_color = BSP_LCD_ReadPixel(x, y);
		BSP_LCD_DrawPixel(x, y, couleur);
		if ((BSP_LCD_ReadPixel(x + 1, y) == px_color)
				&& TestConditionBord(x + 1, y, 0))
			LCD_PAINTBRUSH(x + 1, y, rad);
		if ((BSP_LCD_ReadPixel(x - 1, y) == px_color)
				&& TestConditionBord(x - 1, y, 0))
			LCD_PAINTBRUSH(x - 1, y, rad);
		if ((BSP_LCD_ReadPixel(x, y + 1) == px_color)
				&& TestConditionBord(x, y+1, 0))
			LCD_PAINTBRUSH(x, y + 1, rad);
		if ((BSP_LCD_ReadPixel(x, y - 1) == px_color)
				&& TestConditionBord(x, y-1, 0))
			LCD_PAINTBRUSH(x, y - 1, rad);
		break;
	}
}
/*
 * Dessine la forme du pinceau actuel pour la zone menu (fonction séparé car
 * pour la fonction de remplissage du fond on veut juste afficher un logo).
 */
void LCD_PAINTBRUSH_SAMPLE(uint16_t x, uint16_t y,uint16_t rad)
{
	uint32_t color;
	switch(brush)
	{
	case 0 :
		BSP_LCD_FillCircle(x, y, rad);
		break;
	case 1 :
		for(int i=0; i<30;i++)
		{
			for(int j=0; j<30;j++)
			{
				if(brush_background[i][j]==0) BSP_LCD_DrawPixel(x-15+j, y-15+i, LCD_COLOR_BLACK);
			}
		}
		break;
	case 2 :
		for(int i=0; i<34;i++)
		{
			for(int j=0; j<30;j++)
			{
				color = brush_remplir[i][j] | (brush_remplir[i][j]<<8) | (brush_remplir[i][j]<<16) | 0xFF000000;
				BSP_LCD_DrawPixel(x-15+j, y-15+i, color);
			}
		}
		break;
	}
}
/*
 * Affiche le spectre RVB pour que l'utilisateur puisse faire son choix de couleur
 * pour afficher toutes les tonalité il faudrait 256*6 = 1536 pixels, on prend donc que
 * 64 niveaux de tonalité pour chaque mélange (R+V, V+R, V+B, B+V, B+R, R+B). Soit un total
 * de 64*6 = 384 pixels nécessaire
 */
void AfficheTonalite()
{
	uint32_t RVB = 0x0;
	BSP_LCD_SelectLayer(1);
	BSP_LCD_SetTextColor(LCD_COLOR_WHITE);
	BSP_LCD_FillRect(0, 251, 480, 21);
	//affichage R+V :
	for(uint32_t i = 0;i<256; i = i+4)
   {
		RVB = 0xFFFF0000 | (i<<8); //Red à 255, Vert augmente
		for(char j = 0; j<18; j++)
		{
			BSP_LCD_DrawPixel(50+i/4, 252+j, RVB);
		}
   }
	//affichage V+R :
	for(uint32_t i = 252;i<253; i = i-4)
		// i est un uint donc quand i passe en dessus de 0 il est interprèter comme un grand nombre d'où le i<253
   {
		RVB = 0xFF00FF00 | (i<<16); //Vert à 255, Red diminue
		for(char j = 0; j<18; j++)
		{
			BSP_LCD_DrawPixel(114+(63-i/4), 252+j, RVB);
		}
   }
	//affichage V+B :
	for(uint32_t i = 0;i<256; i = i+4)
   {
		RVB = 0xFF00FF00 | i; // Vert à 255, Bleu augmente
		for(char j = 0; j<18; j++)
		{
			BSP_LCD_DrawPixel(178+i/4, 252+j, RVB);
		}
   }
	//affichage B+V :
	for(uint32_t i = 252;i<253; i = i-4)
   {
		RVB = 0xFF0000FF | (i<<8); // Bleu à 255, Vert diminue
		for(char j = 0; j<18; j++)
		{
			BSP_LCD_DrawPixel(242+(63-i/4), 252+j, RVB);
		}
   }
	//affichage B+R :
	for(uint32_t i = 0;i<256; i = i+4)
   {
		RVB = 0xFF0000FF | (i<<16);// Bleu à 255, Red augmente
		for(char j = 0; j<18; j++)
		{
			BSP_LCD_DrawPixel(306+i/4, 252+j, RVB);
		}
   }
	//affichage R+B :
	for(uint32_t i = 252;i<253; i = i-4)
   {
		RVB = 0xFFFF0000 | (i);// Red à 255, Bleu diminue
		for(char j = 0; j<18; j++)
		{
			BSP_LCD_DrawPixel(370+(63-i/4), 252+j, RVB);
		}
   }
	osDelay(200);
}

/*
 * Affiche le dégradé de luminosité pour que l'utilisateur puisse faire son choix
 */
void AfficheLuminosite(float ton, float sat)
{
	float lum;
	uint32_t color;
	BSP_LCD_SelectLayer(1);
	BSP_LCD_SetTextColor(LCD_COLOR_WHITE);
	BSP_LCD_FillRect(0, 251, 480, 21);
	for(uint32_t i = 0;i<256;i++)
    {
		lum = (float)i/255;
		color = FindCouleur(ton, sat, lum) | 0xFF000000;
		for(char j = 0; j<18; j++)
		{
			BSP_LCD_DrawPixel(100+i, 252+j, color);
		}
    }
	osDelay(200);
}

/*
 * Affiche le dégradé de saturation pour que l'utilisateur puisse faire son choix
 */
void AfficheSaturation(float ton, float lum)
{
	float sat;
	uint32_t color;
	BSP_LCD_SelectLayer(1);
	BSP_LCD_SetTextColor(LCD_COLOR_WHITE);
	BSP_LCD_FillRect(0, 251, 480, 21);
	for(uint32_t i = 0;i<256;i++)
    {
		sat = (float)i/255;
		color = FindCouleur(ton, sat, lum) | 0xFF000000;
		for(char j = 0; j<18; j++)
		{
			BSP_LCD_DrawPixel(100+i, 252+j, color);
		}
    }
	osDelay(200);
}

/*
 * trouve la couleur RVB à partir de la couleur TSL:
 * renvoi un entier de la forme RGB-888 : 0xRRVVBB
 */
uint32_t FindCouleur(float ton, float sat, float lum)
{
	char Red, Green, Blue;
	uint32_t color = 0;
	float R = 0;
	float V = 0;
	float B = 0;
	float C;
	float m;
	float T_prime;
	float X;
	C = lum*sat;
	m = lum-C;
	T_prime = ton/60;
	X = C*(1-absolu((modulo(T_prime, 2))-1));
	if((T_prime>=0) && (T_prime<1))
	{
		R = C;
		V = X;
	}
	else if(T_prime<2)
	{
		R = X;
		V = C;
	}
	else if(T_prime<3)
	{
		B = X;
		V = C;
	}
	else if(T_prime<4)
	{
		B = C;
		V = X;
	}
	else if(T_prime<5)
	{
		B = C;
		R = X;
	}
	else if(T_prime<6)
	{
		R = C;
		B = X;
	}
	R = (R+m)*255;
	V = (V+m)*255;
	B = (B+m)*255;
	Red = (int)R;
	Green = (int)V;
	Blue = (int)B;
	color = (Red<<16)+(Green<<8)+Blue;
	return color;
}
/*
 * Renvoi la tonalité entre 0° et 360° à partir de la position du doigt sur la barre
 */
float FindTonalite(uint16_t pos)
{
	float ton;
	ton = (float)pos;
	ton = (ton/383)*360;
	return ton;
}

/*
 * Renvoi la Luminosité entre 0 et 1 à partir de la position du doigt sur la barre
 */
float FindLuminosite(uint16_t pos)
{
	return (float) pos/255;
}

/*
 * Renvoi la Saturation entre 0 et 1 à partir de la position du doigt sur la barre
 */
float FindSaturation(uint16_t pos)
{
	return (float)pos/255;
}

float modulo(float val, char mod)
{
	uint32_t q;
	q = (int) val/mod;
	return(val - 2*q);
}

float absolu(float val)
{
	if(val<0) return -val;
	else return val;
}
/* USER CODE END 4 */

void StartDefaultTask(void const * argument)
{
  for(;;)
  {
    osDelay(1);
  }
}

void StartMode(void const * argument)
{
  /* USER CODE BEGIN StartMode */
  /* Infinite loop */
  TickType_t xLastWakeTime;
  xLastWakeTime = xTaskGetTickCount();
  static TS_StateTypeDef  TS_State;
  char radius_prec; //rayon précédent pour supprimer le curseur dans la sélection
  char sous_menu = 0; // permet de savoir si on est dans un sous menu
  char menu_couleur = 0; // permet de savoir si on est dans un des sous_menu couleur (tonalité, saturation, luminosité)
  //valeur TSL pour la couleur
  float ton = 180.0;
  float lum = 0.5;
  float sat = 0.5;
  char text[] = "   Layer   |   Pinceau   | Transparence |   Couleur   |    Taille   ";
  char text_layer[] = "Calque 1        |        Calque 2";
  char text_alpha[] = "Choisir la transparence : ";
  char text_couleur[] = "Tonalite  |    Saturation    | Luminosite";
  couleur = FindCouleur(180,0.5,0.5)|0xFF000000;
  char text_taille[] = "Taille du pinceau :   px";
  char text_brush[] = " <<<<            Valider            >>>>";
  char demande_envoi[] = "d";
  char confirmation;
  uint32_t pixel;
  char R,V,B;
  for(;;)
  {
	  switch(etat)
	  {
	  /*
	   *  etat de repos aucun mode n'est changé
	   */
	  case 0 :
		  break;
	  /*
	   * etat d'affichage du menu
	   */
	  case 1 :
		  if(myMutexLCDHandle != NULL)
		  {
			   if(xSemaphoreTake(myMutexLCDHandle,1) == pdTRUE)
			   {
				   BSP_LCD_SelectLayer(1);
				   BSP_LCD_SetFont(&Font12);
				   BSP_LCD_SetTextColor(LCD_COLOR_WHITE);
				   BSP_LCD_FillRect(0, 251, 480, 21);
				   BSP_LCD_SetTextColor(LCD_COLOR_RED);
				   BSP_LCD_DisplayStringAt(0, 252,(uint8_t*) text, CENTER_MODE);
				   BSP_LCD_SetTextColor(LCD_COLOR_BLACK);
				   LCD_PAINTBRUSH_SAMPLE(480-taille_menu/2, 3*taille_menu/2, taille_menu/2-5);
				   BSP_LCD_SetTextColor(0xFFFF00FF); //violet
				   BSP_LCD_FillRect(98*etat_int-170, 265, 35, 5);
				   BSP_LCD_SetTextColor(couleur | 0xFF000000);
				   BSP_LCD_FillCircle(480-taille_menu/2, taille_menu/2, taille_menu/2-5);
				   BSP_LCD_SetTextColor(couleur & 0xFF000000);
				   BSP_LCD_FillCircle(480-taille_menu/2, 5*taille_menu/2, taille_menu/2-5);
				   BSP_LCD_SelectLayer(layer);
				   BSP_LCD_SetTextColor(couleur);
				   xSemaphoreGive(myMutexLCDHandle);
			   }
		   }
		  etat = 0;
		  break;
	  /*
	   * etat de sélection du calque
	   */
	  case 2 :
		  if(sous_menu == 0)
		  {
			  if(myMutexLCDHandle != NULL)
			  {
				   if(xSemaphoreTake(myMutexLCDHandle,1) == pdTRUE)
				   {
					   BSP_LCD_SelectLayer(1);
					   BSP_LCD_SetFont(&Font12);
					   BSP_LCD_SetTextColor(LCD_COLOR_WHITE);
					   BSP_LCD_FillRect(0, 251, 480, 21);
					   BSP_LCD_SetTextColor(LCD_COLOR_RED);
					   BSP_LCD_DisplayStringAt(0, 252,(uint8_t*) text_layer, CENTER_MODE);
					   xSemaphoreGive(myMutexLCDHandle);
				   }
			   }

		  }
		  sous_menu = 1;
		  BSP_TS_GetState(&TS_State);
		  if(TS_State.touchDetected)
		  {
			  if((TS_State.touchX[0]<240) && TS_State.touchY[0] > 272-haut_menu)
			  {
				  layer = 0;
				  sous_menu = 0;
			  }
			  else if((TS_State.touchX[0]>240) && TS_State.touchY[0] > 272-haut_menu)
			  {
				  layer = 1;
				  sous_menu = 0;
			  }
		  }
		  if(sous_menu == 0) etat = 1; //on revient au menu de base
		  break;
	  /*
	   * etat de sélection du pinceau
	   */
	  case 3 :
		  if(sous_menu == 0)
		  {
			  if(myMutexLCDHandle != NULL)
			  {
				   if(xSemaphoreTake(myMutexLCDHandle,1) == pdTRUE)
				   {
					   BSP_LCD_SelectLayer(1);
					   BSP_LCD_SetFont(&Font12);
					   BSP_LCD_SetTextColor(LCD_COLOR_WHITE);
					   BSP_LCD_FillRect(0, 251, 480, 21);
					   BSP_LCD_SetTextColor(LCD_COLOR_RED);
					   BSP_LCD_DisplayStringAt(0, 252,(uint8_t*) text_brush, CENTER_MODE);
					   xSemaphoreGive(myMutexLCDHandle);
				   }
			   }

		  }
		  sous_menu = 1;
		  BSP_TS_GetState(&TS_State);
		  if(TS_State.touchDetected)
		  {
			  if((TS_State.touchX[0]<190) && TS_State.touchY[0] > 272-haut_menu)
			  {
				  if(brush==0) brush = max_brush;
				  else brush -= 1;
				  if(myMutexLCDHandle != NULL)
				  {
					   if(xSemaphoreTake(myMutexLCDHandle,1) == pdTRUE)
					   {
						  BSP_LCD_SetTextColor(LCD_COLOR_WHITE);
						  BSP_LCD_FillRect(480-taille_menu , taille_menu, taille_menu-1, taille_menu);
						  BSP_LCD_SetTextColor(LCD_COLOR_BLACK);
						  LCD_PAINTBRUSH_SAMPLE(480-taille_menu/2, 3*taille_menu/2, taille_menu/2-5);
						  BSP_LCD_SetTextColor(couleur);
						  xSemaphoreGive(myMutexLCDHandle);
					   }
				  }
				  while(TS_State.touchDetected) BSP_TS_GetState(&TS_State);;
			  }
			  else if((TS_State.touchX[0]>290) && TS_State.touchY[0] > 272-haut_menu)
			  {
				  if(brush==max_brush) brush = 0;
				  else brush += 1;
				  if(myMutexLCDHandle != NULL)
				  {
					   if(xSemaphoreTake(myMutexLCDHandle,1) == pdTRUE)
					   {
						  BSP_LCD_SetTextColor(LCD_COLOR_WHITE);
						  BSP_LCD_FillRect(480-taille_menu , taille_menu, taille_menu-1, taille_menu);
						  BSP_LCD_SetTextColor(LCD_COLOR_BLACK);
						  LCD_PAINTBRUSH_SAMPLE(480-taille_menu/2, 3*taille_menu/2, taille_menu/2-5);
						  BSP_LCD_SetTextColor(couleur);
						  xSemaphoreGive(myMutexLCDHandle);
					   }
				  }
				  while(TS_State.touchDetected) BSP_TS_GetState(&TS_State);;
			  }
			  else if((TS_State.touchX[0]>190) && (TS_State.touchY[0] > 272-haut_menu) && (TS_State.touchX[0]<290))
			  {
				  sous_menu = 0;
			  }
		  }
		  if(sous_menu == 0) etat = 1; //on revient au menu de base
		  break;
	  /*
	   * etat de sélection de la transparence
	   */
	  case 4 :
		  if(sous_menu == 0)
		  {
			  if(myMutexLCDHandle != NULL)
			  {
				   if(xSemaphoreTake(myMutexLCDHandle,1000) == pdTRUE)
				   {
					   BSP_LCD_SelectLayer(1);
					   BSP_LCD_SetTextColor(LCD_COLOR_WHITE);
					   BSP_LCD_FillRect(0, 251, 480, 21);
					   BSP_LCD_SetTextColor(LCD_COLOR_RED);
					   BSP_LCD_DisplayStringAt(0, 252,(uint8_t*) text_alpha, LEFT_MODE);
					   for(uint32_t i = 0;i<256; i++)
					   {
						   for(char j = 0; j<18; j++)
						   {
							   BSP_LCD_DrawPixel(200+i, 252+j, i << 24);
						   }
					   }
					   xSemaphoreGive(myMutexLCDHandle);
				   }
			   }
		  }
		  sous_menu = 1;
		  BSP_TS_GetState(&TS_State);
		  while(TS_State.touchDetected)
		  {
			  if((TS_State.touchX[0]>200) && (TS_State.touchY[0] > 272-haut_menu) && (TS_State.touchX[0]<455))
			  {
				  couleur &= 0x00FFFFFF; //on enlève l'ancienne transparence
				  couleur |= ((TS_State.touchX[0]-200)<<24);
				  if(myMutexLCDHandle != NULL)
				  {
					   if(xSemaphoreTake(myMutexLCDHandle,100) == pdTRUE)
					   {
						   BSP_LCD_SetTextColor(couleur & 0xFF000000);
						   BSP_LCD_FillCircle(480-taille_menu/2, 5*taille_menu/2, taille_menu/2-5);
						   xSemaphoreGive(myMutexLCDHandle);
					   }
				   }
			  }
			  sous_menu = 0;
			  BSP_TS_GetState(&TS_State);
		  }
		  if(sous_menu == 0) etat = 1;
		  break;
	  /*
	   * etat de sélection de la couleur
	   */
	  case 5 :
		  if(sous_menu == 0)
		  {
			  if(myMutexLCDHandle != NULL)
			  {
				   if(xSemaphoreTake(myMutexLCDHandle,1000) == pdTRUE)
				   {
					   BSP_LCD_SelectLayer(1);
					   BSP_LCD_SetTextColor(LCD_COLOR_WHITE);
					   BSP_LCD_FillRect(0, 251, 480, 21);
					   BSP_LCD_SetTextColor(LCD_COLOR_RED);
					   BSP_LCD_DisplayStringAt(0, 252,(uint8_t*) text_couleur, CENTER_MODE);
					   xSemaphoreGive(myMutexLCDHandle);
				   }
			  }
		  }
		  sous_menu = 1;
		  switch(menu_couleur)
		  {
		  /*
		   * premier sous_menu : choix entre tonalité, saturation et luminosité
		   */
		  case 0 :
			  BSP_TS_GetState(&TS_State);
			  if(TS_State.touchDetected && menu_couleur == 0)
			  {
				  if((TS_State.touchX[0]<170) && TS_State.touchY[0] > 272-haut_menu)
					  // clique sur tonalité
				  {
					  menu_couleur = 1;
					  if(myMutexLCDHandle != NULL)
					  {
						   if(xSemaphoreTake(myMutexLCDHandle,1000) == pdTRUE)
						   {
							   AfficheTonalite();
							   xSemaphoreGive(myMutexLCDHandle);
						   }
					  }
				  }
				  else if((TS_State.touchX[0]>310) && TS_State.touchY[0] > 272-haut_menu)
					  //clique sur luminosité
				  {
					  menu_couleur = 2;
					  if(myMutexLCDHandle != NULL)
					  {
						   if(xSemaphoreTake(myMutexLCDHandle,1000) == pdTRUE)
						   {
							   AfficheLuminosite(ton, sat);
							   xSemaphoreGive(myMutexLCDHandle);
						   }
					  }
				  }
				  else if((TS_State.touchX[0]<310) && (TS_State.touchY[0] > 272-haut_menu) && (TS_State.touchX[0]>170))
					  //clique sur saturation
				  {
					  menu_couleur = 3;
					  if(myMutexLCDHandle != NULL)
					  {
						   if(xSemaphoreTake(myMutexLCDHandle,1000) == pdTRUE)
						   {
							   AfficheSaturation(ton, lum);
							   xSemaphoreGive(myMutexLCDHandle);
						   }
					  }
				  }
			  }
			  break;
		  /*
		   * on a affiché l'arc en ciel des tonalités, l'utilisateur choisit maintenant celle-ci.
		   */
		  case 1:
			  BSP_TS_GetState(&TS_State);
			  while(TS_State.touchDetected)
			  {
				  if((TS_State.touchX[0]>=50) && (TS_State.touchY[0] > 272-haut_menu) && (TS_State.touchX[0]<433))
				  {
					  ton = FindTonalite(TS_State.touchX[0]-50);
					  couleur = FindCouleur(ton, sat, lum) | (couleur & 0xFF000000);
					  if(myMutexLCDHandle != NULL)
					  {
						   if(xSemaphoreTake(myMutexLCDHandle,100) == pdTRUE)
						   {
							   BSP_LCD_SetTextColor(couleur | 0xFF000000);
							   BSP_LCD_FillCircle(480-taille_menu/2, taille_menu/2, taille_menu/2-5);
							   xSemaphoreGive(myMutexLCDHandle);
						   }
					   }
				  }
				  menu_couleur = 0;
				  sous_menu = 0;
				  BSP_TS_GetState(&TS_State);
			  }
			  break;
		  /*
		   * On a Affiché le dégradé de luminosité, l'utilisateur chosit maintenant celle-ci
		   */
		  case 2:
			  BSP_TS_GetState(&TS_State);
			  while(TS_State.touchDetected)
			  {
				  if((TS_State.touchX[0]>=100) && (TS_State.touchY[0] > 272-haut_menu) && (TS_State.touchX[0]<=356))
				  {
					  lum = FindLuminosite(TS_State.touchX[0]-100);
					  couleur = FindCouleur(ton, sat, lum) | (couleur & 0xFF000000);
					  if(myMutexLCDHandle != NULL)
					  {
						   if(xSemaphoreTake(myMutexLCDHandle,100) == pdTRUE)
						   {
							   BSP_LCD_SetTextColor(couleur | 0xFF000000);
							   BSP_LCD_FillCircle(480-taille_menu/2, taille_menu/2, taille_menu/2-5);
							   xSemaphoreGive(myMutexLCDHandle);
						   }
					   }
				  }
				  menu_couleur = 0;
				  sous_menu = 0;
				  BSP_TS_GetState(&TS_State);
			  }
			  break;
		  /*
		   * On a Affiché le dégradé de saturation, l'utilisateur chosit maintenant celle-ci
		   */
		  case 3:
			  BSP_TS_GetState(&TS_State);
			  while(TS_State.touchDetected)
			  {
				  if((TS_State.touchX[0]>=100) && (TS_State.touchY[0] > 272-haut_menu) && (TS_State.touchX[0]<=356))
				  {
					  sat = FindSaturation(TS_State.touchX[0]-100);
					  couleur = FindCouleur(ton, sat, lum) | (couleur & 0xFF000000);
					  if(myMutexLCDHandle != NULL)
					  {
						   if(xSemaphoreTake(myMutexLCDHandle,100) == pdTRUE)
						   {
							   BSP_LCD_SetTextColor(couleur | 0xFF000000);
							   BSP_LCD_FillCircle(480-taille_menu/2, taille_menu/2, taille_menu/2-5);
							   xSemaphoreGive(myMutexLCDHandle);
						   }
					   }
				  }
				  menu_couleur = 0;
				  sous_menu = 0;
				  BSP_TS_GetState(&TS_State);
			  }
			  break;
		  }
		  if(sous_menu==0) etat = 1;
		  break;
	  /*
	   * etat de sélection de la taille
	   */
	  case 6 :
		  if(sous_menu == 0)
		  {
			  if(myMutexLCDHandle != NULL)
			  {
				   if(xSemaphoreTake(myMutexLCDHandle,1000) == pdTRUE)
				   {
					   BSP_LCD_SelectLayer(1);
					   BSP_LCD_SetTextColor(LCD_COLOR_WHITE);
					   BSP_LCD_FillRect(0, 251, 480, 21);
					   BSP_LCD_SetTextColor(LCD_COLOR_RED);
					   BSP_LCD_DisplayStringAt(0, 252,(uint8_t*) text_taille, LEFT_MODE);
					   BSP_LCD_SetTextColor(LCD_COLOR_BLACK);
					   BSP_LCD_DrawHLine(220, 261, 240);
					   BSP_LCD_DrawVLine(220, 252, 18);
					   BSP_LCD_DrawVLine(460, 252, 18);
					   BSP_LCD_SetTextColor(LCD_COLOR_RED);
					   BSP_LCD_FillRect(220+12*radius, 252, 5, 18);
					   BSP_LCD_SetTextColor(couleur);
					   xSemaphoreGive(myMutexLCDHandle);
				   }
			  }
		  }
		  sous_menu = 1;
		  BSP_TS_GetState(&TS_State);
		  while(TS_State.touchDetected)
		  {
			  if((TS_State.touchX[0]>220) && (TS_State.touchY[0] > 272-haut_menu) && (TS_State.touchX[0]<460))
			  {
				  radius_prec = radius;
				  radius = (TS_State.touchX[0]-208)/12;
				  if(myMutexLCDHandle != NULL)
				  {
					   if(xSemaphoreTake(myMutexLCDHandle,100) == pdTRUE)
					   {
						   BSP_LCD_SetTextColor(LCD_COLOR_WHITE);
						   BSP_LCD_FillRect(220+12*radius_prec, 252, 5, 18);
						   BSP_LCD_SetTextColor(LCD_COLOR_BLACK);
						   BSP_LCD_DrawHLine(220, 261, 240);
						   BSP_LCD_SetTextColor(LCD_COLOR_RED);
						   BSP_LCD_FillRect(220+12*radius, 252, 5, 18);
						   xSemaphoreGive(myMutexLCDHandle);
					   }
				   }
			  }
			  sous_menu = 0;
			  BSP_TS_GetState(&TS_State);
		  }
		  if(sous_menu==0) etat = 1;
		  break;
	  /*
	   * etat de clear de la page de dessin.
	   */
	  case 7 :
		  if(myMutexLCDHandle != NULL)
		  {
			   if(xSemaphoreTake(myMutexLCDHandle,100) == pdTRUE)
			   {
				  BSP_LCD_SelectLayer(0);
				  BSP_LCD_SetTextColor(LCD_COLOR_WHITE);
				  BSP_LCD_FillRect(0, 0, 480-taille_menu-5, 246);
				  BSP_LCD_SelectLayer(1);
				  BSP_LCD_SetTextColor(LCD_COLOR_TRANSPARENT);
				  BSP_LCD_FillRect(0, 0, 480-taille_menu-5, 246);
				  xSemaphoreGive(myMutexLCDHandle);
			   }
		   }
		  etat = 1;
		  break;
	  /*
	   * etat d'enregistrement du dessin
	   */
	  case 8 :
		  HAL_UART_Transmit(&huart1, demande_envoi, 1, 100);
		  HAL_UART_Receive(&huart1, &confirmation, 1, 250);
		  if(confirmation=='a')
		  {
			  for(int i = 0; i<246; i++)
			  {
				  for(int j = 0; j<425;j++)
				  {
					  pixel = BSP_LCD_ReadPixel(j, i);
					  R = (pixel >> 16) & 0xFF;
					  V = (pixel >> 8) & 0xFF;
					  B = pixel & 0xFF;
					  HAL_UART_Transmit(&huart1, &R, 1, 100);
					  HAL_UART_Transmit(&huart1, &V, 1, 100);
					  HAL_UART_Transmit(&huart1, &B, 1, 100);
				  }
			  }
			  confirmation = 'n';
		  }
		  etat = 1;
		  break;
	  }
	  vTaskDelayUntil(&xLastWakeTime, 100);
  }
  /* USER CODE END StartMode */
}

void StartPeindre(void const * argument)
{
  /* USER CODE BEGIN StartPeindre */
	static TS_StateTypeDef  TS_State;
	/* Infinite loop */
	for(;;)
	{
	  BSP_TS_GetState(&TS_State);
	  if(TS_State.touchDetected && (TestConditionBord(TS_State.touchX[0], TS_State.touchY[0], radius)))
	  {
		  if(myMutexLCDHandle != NULL)
		   {
			   if(xSemaphoreTake(myMutexLCDHandle,1) == pdTRUE)
			   {
				   LCD_PAINTBRUSH(TS_State.touchX[0],TS_State.touchY[0],radius);
				   xSemaphoreGive(myMutexLCDHandle);
			   }
		   }
	  }
	}
  /* USER CODE END StartPeindre */
}

void StartTaskEtat(void const * argument)
{
  /* USER CODE BEGIN StartTaskEtat */
	TickType_t xLastWakeTime;
	xLastWakeTime = xTaskGetTickCount();
	ADC_ChannelConfTypeDef sConfig = {0};
	sConfig.Rank = ADC_REGULAR_RANK_1;
	sConfig.SamplingTime = ADC_SAMPLETIME_3CYCLES;
	sConfig.Channel = ADC_CHANNEL_8;
	HAL_ADC_ConfigChannel(&hadc3, &sConfig);
	char etat_prec = 2;
	uint16_t joystick_h;
	/* Infinite loop */
	for(;;)
	{
	  if(etat == 0)
	  {
		  HAL_ADC_Start(&hadc1);
		  while(HAL_ADC_PollForConversion(&hadc1, 100)!=HAL_OK);
		  joystick_h = HAL_ADC_GetValue(&hadc1);
		  if(joystick_h > 2500)
		  {
			  etat_prec = etat_int;
			  etat_int -= 1;
			  if(etat_int < 2) etat_int = etat_max;
			  if(myMutexLCDHandle != NULL)
			   {
				   if(xSemaphoreTake(myMutexLCDHandle,1) == pdTRUE)
				   {
					   BSP_LCD_SelectLayer(1);
					   BSP_LCD_SetTextColor(LCD_COLOR_WHITE);
					   BSP_LCD_FillRect(98*etat_prec-170, 265, 35, 5);
					   BSP_LCD_SetTextColor(0xFFFF00FF);
					   BSP_LCD_FillRect(98*etat_int-170, 265, 35, 5);
					   BSP_LCD_SelectLayer(layer);
					   BSP_LCD_SetTextColor(couleur);
					   xSemaphoreGive(myMutexLCDHandle);
				   }
			   }
		  }
		  else if(joystick_h < 1500)
		  {
			  etat_prec = etat_int;
			  etat_int += 1;
			  if (etat_int > etat_max) etat_int = 2;
			  if(myMutexLCDHandle != NULL)
			   {
				   if(xSemaphoreTake(myMutexLCDHandle,1) == pdTRUE)
				   {
					   BSP_LCD_SelectLayer(1);
					   BSP_LCD_SetTextColor(LCD_COLOR_WHITE);
					   BSP_LCD_FillRect(98*etat_prec-170, 265, 35, 5);
					   BSP_LCD_SetTextColor(0xFFFF00FF); //violet
					   BSP_LCD_FillRect(98*etat_int-170, 265, 35, 5);
					   BSP_LCD_SelectLayer(layer);
					   BSP_LCD_SetTextColor(couleur);
					   xSemaphoreGive(myMutexLCDHandle);
				   }
			   }
		  }
	  }
	  vTaskDelayUntil(&xLastWakeTime, 300);
	}
  /* USER CODE END StartTaskEtat */
}

 /**
  * @brief  Period elapsed callback in non blocking mode
  * @note   This function is called  when TIM6 interrupt took place, inside
  * HAL_TIM_IRQHandler(). It makes a direct call to HAL_IncTick() to increment
  * a global variable "uwTick" used as application time base.
  * @param  htim : TIM handle
  * @retval None
  */
void HAL_TIM_PeriodElapsedCallback(TIM_HandleTypeDef *htim)
{
  if (htim->Instance == TIM6) {
    HAL_IncTick();
  }
}

void Error_Handler(void)
{
  __disable_irq();
  while (1)
  {
  }
}

/************************ (C) COPYRIGHT STMicroelectronics *****END OF FILE****/
